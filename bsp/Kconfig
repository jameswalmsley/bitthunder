## os/src/fs/Kconfig
```kconfig
menu "Filesystems"

config FS
    bool
	default n

config INODE
    bool
	default n

config FS_DEV_DYNAMIC_REGISTRATION
	bool "Dynamic DEVFS registration"
	default n
	select FS
	select INODE

config FS_FULLFAT
    bool "FAT filesystem support (FullFAT)"
	select FS
	select BLOCK
	select VOLUME
	default n

menu "FullFAT Configuration"
    depends on FS_FULLFAT

config FS_FULLFAT_LFN_SUPPORT
    bool "LFN (Long filename) Support"
	default y

choice
	prompt "Allocation Algorithm"
	default FS_FULLFAT_ALLOC_DEFAULT

config FS_FULLFAT_ALLOC_DEFAULT
    bool "Default"

config FS_FULLFAT_ALLOC_DOUBLE
    bool "Double"

endchoice

config FS_FULLFAT_CACHE_SIZE
	int "size of block chache"
	default 8192

config FS_FULLFAT_DRIVER_BUSY_SLEEP
	int "Driver busy sleep time"
	default 20

endmenu

config FS_EXT2
    bool "Ext2 filesystem support (Read Only)"
	select FS
	select BLOCK
	select VOLUME
	default n

endmenu
```

## os/src/gpio/Kconfig
```kconfig
menu "GPIOs"
config MAX_GPIO_CONTROLLERS
	int "Maximum registerable GPIO controllers."
	default 1
	---help---
	This will require extra SRAM bytes if more are allowed.
endmenu
```

## os/src/interrupts/Kconfig
```kconfig
menu "Interrupts"
config MAX_INTERRUPT_CONTROLLERS
    int "Total registerable Interrupt controllers."
	default 1
	---help---
	This will require extra SRAM bytes if more are allowed.

config INTERRUPTS_SOFTIRQ
    bool "Enable SoftIRQ support"
	default n
	---help---
	Enable the use of SoftIRQs, which all run in the specified priority.

config INTERRUPTS_SOFTIRQ_PRIORITY
    int "SoftIRQ Kernel Priority"
	default 0
	depends on INTERRUPTS_SOFTIRQ

config INTERRUPTS_SOFTIRQ_MAX
	int "Total SoftIRQ numbers"
	range 1 32
	default 32
	depends on INTERRUPTS_SOFTIRQ
endmenu

menu "Tasklets"
config TASKLETS
    bool "Tasklet support"
	default n
	select INTERRUPTS_SOFTIRQ
endmenu
```

## os/src/lib/Kconfig
```kconfig
menu "Library Support"

config LIB_PRINTF
	depends on OS
    bool "Use simple printf from BT"
	default y

menu "printf features"
depends on LIB_PRINTF
config LIB_PRINTF_SUPPORT_HEX
    bool "Support %x format specifier"
	default y
	depends on LIB_PRINTF
endmenu


endmenu
```

## os/src/loader/Kconfig
```kconfig
menu "Loader"

config LOADER
	bool "Enable Dynamic loading"
	default n

config LOADER_ELF
	bool "Support ELF file loading"
	default n
	depends on LOADER

endmenu
```
