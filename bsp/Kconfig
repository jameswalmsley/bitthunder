## bsp/arm/Kconfig
```kconfig
choice
	prompt		"BSP Selection"

	config BSP_ARM_LPCEXPRESSO_LPC11c24
	  depends on ARCH_ARM && MACH_LPC11xx
	  bool "LPC11c24 Expresso Board"

	config BSP_ARM_LPCEXPRESSO_LPC1769
	  depends on ARCH_ARM && MACH_LPC17xx
	  bool "LPC1769 Expresso Board"

	config BSP_ARM_LPCEXPRESSO_LM3S9B92
	  depends on ARCH_ARM && MACH_LM3Sxx
	  bool "LM3SBb92"

	config BSP_ARM_RASPBERRY_PI
	  depends on ARCH_ARM && MACH_BCM2835
	  bool "Raspberry Pi"

	config BSP_ARM_ZYNQ_ZED_BOARD
	  depends on ARCH_ARM && MACH_ZYNQ
	  bool "Zynq ZED_BOARD"

endchoice

if BSP_ARM_LPCEXPRESSO_LPC11c24
source bsp/arm/lpcexpresso/11c24/Kconfig
endif

if BSP_ARM_LPCEXPRESSO_LPC1769
source bsp/arm/lpcexpresso/1769/Kconfig
endif

if BSP_ARM_LPCEXPRESSO_LM3S9B92
source bsp/arm/cortex-m3/lm3s9b92/Kconfig
endif

if BSP_ARM_RASPBERRY_PI
source bsp/arm/raspberrypi/Kconfig
endif

if BSP_ARM_ZYNQ_ZED_BOARD
source bsp/arm/zynq/zed-board/Kconfig
endif
```

## bsp/arm/lpcexpresso/11c24/Kconfig
```kconfig
comment "LPC11c24 Options"

config BSP_DIR
	   string
	   default "bsp/arm/lpcexpresso/11c24/"

config BSP_NAME
	   string
	   default "LPC11c24 Expresso board"

comment "CLOCK configuration"

config MACH_LPC11xx_SYSCLOCK_FREQ
    int "System clock frequency"
    default 12000000

choice
	prompt "MAINCLK_SRC"	
	default MAINCLK_SRC_IRC

config MAINCLK_SRC_IRC
    bool	"IRC"
    
config MAINCLK_SRC_PLL_IN
    bool	"PLL_In"
    
config MAINCLK_SRC_WDT
    bool	"WDT_OSC"
	
config MAINCLK_SRC_PLL_OUT
    bool	"PLL_Out"

endchoice

config MAINCLK_SRC
    int
    default 0 if MAINCLK_SRC_IRC
    default 1 if MAINCLK_SRC_PLL_IN
    default 2 if MAINCLK_SRC_WDT
    default 3 if MAINCLK_SRC_PLL_OUT


choice
	prompt "SYSCLK_CTRL"	
	default SYSCLK_CTRL_0

config SYSCLK_CTRL_0
    bool	"NO_BYPASS_1_20MHz"
    
config SYSCLK_CTRL_1
    bool	"BYPASS_1_20MHz"
    
config SYSCLK_CTRL_2
    bool	"NO_BYPASS_15_25MHz"
	
config SYSCLK_CTRL_3
    bool	"BYPASS_15_25MHz"

endchoice

config SYSCLK_CTRL
    int
    default 0 if SYSCLK_CTRL_0
    default 1 if SYSCLK_CTRL_1
    default 2 if SYSCLK_CTRL_2
    default 3 if SYSCLK_CTRL_3


choice
	prompt "PLLCLK_SRC"	
	default PLLCLKK_SRC_IRC

config PLLCLKK_SRC_IRC
    bool	"IRC"
    
config PLLCLK_SRC_SYS_OSC
    bool	"SYS_OSC"
    
endchoice

config PLLCLK_SRC
    int
    default 0 if PLLCLKK_SRC_IRC
    default 1 if PLLCLK_SRC_SYS_OSC

config PLLCLK_CTRL
    hex "PLLClock Control"
    default 0
    ---help---
		bits 0..4 describe the multiplier(Value+1) for the output frequency of the PLL(has to be lower than 100MHz).
		bits 5..6 describe the multiplier((Value+1)*2) for the CCO frequency of the PLL(has to be between 156MHz and 320MHz).
    
config WDTCLK_CTRL
    hex "Watchdog oscillator"
    default 20

config SYSCLK_DIV
    int "System clock divider"
    default 1
```

## bsp/arm/lpcexpresso/1769/Kconfig
```kconfig
comment "LPC1769 Options"

config BSP_DIR
	   string
	   default "bsp/arm/lpcexpresso/1769/"

config BSP_NAME
	   string
	   default "LPC1769 Expresso board"

comment "CLOCK configuration"

config MACH_LPC17xx_SYSCLOCK_FREQ
    int "System clock frequency"
    default 12000000

choice
	prompt "Main PLL Clocksource"	
	default MACH_LPC17xx_MAINPLLCLK_SRC_IRC

config MACH_LPC17xx_MAINPLLCLK_SRC_IRC
    bool	"IRC"
    
config MACH_LPC17xx_MAINPLLCLK_SRC_OSC
    bool	"Main OSC"
    
config MACH_LPC17xx_MAINPLLCLK_SRC_RTC
    bool	"RTC_OSC"
       	
endchoice

config MAINPLLCLK_SRC
    int
    default 0 if MACH_LPC17xx_MAINPLLCLK_SRC_IRC
    default 1 if MACH_LPC17xx_MAINPLLCLK_SRC_OSC
    default 2 if MACH_LPC17xx_MAINPLLCLK_SRC_RTC

config MAINPLLCLK_CTRL
	hex "MAIN PLLClock Control"
	default 0x00010018
    ---help---
		bits 0..14 describe the multiplier M(Value = M-1)
		bits 16..23 describe the divider N (Value = N-1).
		Output frequency = Fin*M*2/N (has to be in the range of 275MHZ to 550MHz)
		

choice
	prompt "SYSCLK_CTRL"	
	default MACH_LPC17xx_SYSCLK_CTRL_1

config MACH_LPC17xx_SYSCLK_CTRL_0
    bool	"1_20MHz_XTAL"
    
config MACH_LPC17xx_SYSCLK_CTRL_1
    bool	"1_20MHz_OSC"
    
config MACH_LPC17xx_SYSCLK_CTRL_2
    bool	"15_25MHz_XTAL"
	
config MACH_LPC17xx_SYSCLK_CTRL_3
    bool	"15_25MHz_OSC"

endchoice

config SYSCLK_CTRL
    int
    default 0  if MACH_LPC17xx_SYSCLK_CTRL_0
    default 32 if MACH_LPC17xx_SYSCLK_CTRL_1
    default 16 if MACH_LPC17xx_SYSCLK_CTRL_2
    default 48 if MACH_LPC17xx_SYSCLK_CTRL_3

config SYSCLK_DIV
    int "System clock divider"
    default 3

choice
	prompt "USB Clocksource"	
	default MACH_LPC17xx_USBCLK_SRC_USBPLL

config MACH_LPC17xx_USBCLK_SRC_USBPLL
    bool	"USB PLL"
    
config MACH_LPC17xx_USBCLK_SRC_MAINPLL
    bool	"Main PLL"
      
endchoice

config USBPLLCLK_CTRL
    hex "USB PLLClock Control"
    default 0
    ---help---
		bits 0..4 describe the multiplier(Value+1) for the output frequency of the PLL(has to be lower than 100MHz).
		bits 5..6 describe the multiplier((Value+1)*2) for the CCO frequency of the PLL(has to be between 156MHz and 320MHz).

config USBCLK_SRC
    int
    default 0 if MACH_LPC17xx_USBCLK_SRC_USBPLL
    default 1 if MACH_LPC17xx_USBCLK_SRC_MAINPLL
    default 2 if MACH_LPC17xx_USBPLLCLK_SRC_RTC
    
config USBCLK_DIV
    int "USB clock divider"
    default 10
```

## bsp/arm/raspberrypi/Kconfig
```kconfig
comment "Raspberry Pi Options"

config BSP_ARM_RASPBERRY_PI_SD
    bool "Board supports  SD-Card"
	select DRIVERS_SDIO	  if OS

config BSP_DIR
	   string
	   default "bsp/arm/raspberrypi/"

config BSP_NAME
	   string
	   default "Raspberry Pi"
```

## bsp/arm/zynq/zed-board/Kconfig
```kconfig
comment "Zynq Zed Board Options"

config BSP_ARM_ZYNQ_ZED_BOARD_SD
    bool "Board supports  SD-Card"
	select DRIVERS_SDIO	  if OS

config BSP_DIR
	   string
	   default "bsp/arm/zynq/zed-board/"

config BSP_NAME
	   string
	   default "Zynq Zed Board"
```

## drivers/Kconfig
```kconfig
comment "Configure all required driver sub-systems"

source drivers/block/Kconfig

source drivers/gpio/Kconfig

source drivers/dac/Kconfig

source drivers/adc/Kconfig

source drivers/mmc/Kconfig

source drivers/mtd/Kconfig

source drivers/net/Kconfig

source drivers/rtc/Kconfig
```

## drivers/adc/Kconfig
```kconfig
menu "ADC Devices"

config DRIVERS_ADC
    bool
	default n

menu "SPI ADC's"

config DRIVERS_ADC_SPI_MAX1231
    bool "MAX1231"
	select DRIVERS_ADC
	default n
endmenu

menu "I2C ADC's"

config DRIVERS_ADC_I2C_MAX1363
    bool "MAX1363"
	select DRIVERS_ADC
	default n
endmenu


endmenu
```

## drivers/block/Kconfig
```kconfig
menu "Block Devices"

config DRIVERS_BLOCK
    bool
	default n
	select BLOCK

config DRIVERS_BLOCK_RAMDISK
    bool "Ramdisk"
	select DRIVERS_BLOCK
	default n

endmenu
```

## drivers/dac/Kconfig
```kconfig
menu "DAC Devices"

config DRIVERS_DAC
    bool
	default n

menu "I2C DAC's"

config DRIVERS_DAC_I2C_MCP4728
    bool "MCP4728"
	select DRIVERS_DAC
	default n
endmenu


endmenu
```

## drivers/gpio/Kconfig
```kconfig
menu "GPIO Devices"

config DRIVERS_GPIO
    bool
	default n

menu "I2C GPIO Expanders"

config DRIVERS_GPIO_I2C_MAX7312
    bool "MAX7312"
	select DRIVERS_GPIO
	default n
endmenu


endmenu
```

## drivers/mmc/Kconfig
```kconfig
menu "MMC / SDCard Subsystem"

config DRIVERS_MMC
    bool "SDCard / MMC Support"
	default n
	select TASKLETS
	select SOFTIRQ

comment "Host Controllers"

config DRIVERS_SDCARD_SDHCI
    bool "SDHCI Support"
	depends on DRIVERS_MMC
	default n

config DRIVERS_SDCARD_SPI
    bool "SPI Support"
	depends on DRIVERS_MMC
	default n
	
config DRIVERS_SDCARD_SPI_CS_GPIO
    int "GPIO Line to use for chip select"
	default -1
	depends on DRIVERS_SDCARD_SPI

config DRIVERS_SDCARD_SPI_DETECT_GPIO
    int "GPIO Line to use for detecting card"
	default -1
	depends on DRIVERS_SDCARD_SPI
	

endmenu
```

## drivers/mtd/Kconfig
```kconfig
menu "MTD Devices"

config DRIVERS_MTD
	bool
	default n
	select MTD
	

menu "SPI Flash devices"

config DRIVERS_MTD_M25P80
    bool "m25p80"
	select DRIVERS_MTD
	default n
endmenu

endmenu
```

## drivers/net/Kconfig
```kconfig
menu "Network Controllers"

config DRIVERS_NET
	bool
	default n

source drivers/net/phy/Kconfig

endmenu
```

## drivers/net/phy/Kconfig
```kconfig
menu "PHYs"

config DRIVERS_NET_PHY_MARVELL
	   bool "Marvell Phys"
	   select DRIVERS_NET
	   default n

endmenu
```

## drivers/rtc/Kconfig
```kconfig
menu "RTC Devices"

config DRIVERS_RTC
    bool
	default n

menu "I2C RTC devices

config DRIVERS_RTC_I2C_DS1338
    bool "DS1338"
	select DRIVERS_RTC
	default n
endmenu


endmenu
```

## kernel/FreeRTOS/Kconfig
```kconfig
config KERNEL_FREERTOS_NEWLIB_REENTRANCY_SUPPORT
	   bool "Support NEWLIB reentrancy model"
	   default y
```

## kernel/Kconfig
```kconfig
choice
	prompt "Kernel/Scheduler selection"
	default KERNEL_FREERTOS

config KERNEL_NONE
    bool "Standalone single-threaded application"
	---help---
	This option allows you to use basic drivers that don't rely on the scheduler
	to create simple single-thread and interrupt driven applications.
	Selecting this option allows you to create a truly tiny bitthunder application.

config KERNEL_FREERTOS
    bool "FreeRTOS Real-time scheduler"

config KERNEL_BT
	bool "BT Kernel (experimental)"

endchoice

if KERNEL_FREERTOS
comment "FreeRTOS Specific options"
source kernel/FreeRTOS/Kconfig
endif

config KERNEL_TICK_RATE
    int "Kernel Tick Frequency (Hz)"
	default 1000

config KERNEL_SYMBOLS
	bool "Generate a Kernel Symbol Table"
	---help---
	Allows loading of loadable kernel modules, and debug information.
```

## os/Kconfig
```kconfig
source os/src/process/Kconfig
source os/src/gpio/Kconfig
source os/src/interrupts/Kconfig
source os/src/fs/Kconfig
source os/src/loader/Kconfig
source os/src/net/Kconfig
source os/src/mm/Kconfig
source os/src/shell/Kconfig
source os/src/syscall/Kconfig
source os/src/syslog/Kconfig
source os/src/time/Kconfig
source os/src/lib/Kconfig

config OF
	bool "Support Device Tree / Open Firmware framework"
	select FS_DEV_DYNAMIC_REGISTRATION
	default n

config CACHE_MAINTENANCE
	bool
	default n

config MAIN_TASK_STACK_DEPTH
    int "Main task stack depth"
	default 512

config MAIN_TASK_PRIORITY
    int "Main task stack priority"
	default 0

config INHERIT_STDIO_FROM_KERNEL
	bool "Inherit STDIO file descriptors from kernel."
	default y
	---help---
	Leave the stdin/stdout file descriptors used as the boot-logger open before starting
	the main process. The main process will then inherit these file-descriptors.

config MULTITHREADED_INIT
	bool "Multi-threaded Init"
	default y

choice
	prompt "Kernel init Behaviour"
	default INIT_WELCOME
	---help---
	The kernel init behaviour effectively defines what happens in the Kernel's main()
	function implementation. All options will be overridden if a project provides it's
	owm main() function in the kernel build.

config INIT_WELCOME
	bool "Welcome Message"
    ---help---
	Prints "Welcome to BitThunder" every second. This is used for getting started and testing
	purposes.

config INIT_SHELL
    bool "Kernel Shell"
	---help---
	Provide an interactive kernel shell on the stdin/stdout boot-console. This is useful
	for some embedded projects like bootloaders.

config INIT_FORK
	bool "Fork /system/init"
	---help---
	Forks an executable in /system/init, i.e. a typical init process. This init option is only
	compatible with MMU based systems.

endchoice

menu "Subsystems"
config BLOCK
    bool "Block device support"
	default n

config BLOCK_SCHEDULER
	bool "Block device manager to use an I/O scheduler"
	default n

config BLOCK_SCHEDULER_THREAD_PER_DEVICE
	bool "Scheduler thread per device"
	default n

config VOLUME
    bool "Volume / Partition Manager"
	default n

config FILE
    bool
	select FS
	default y

config DIR
    bool "Directory I/O interfaces"
	default n

config I2C
    bool "I2C subsystem"
	select SOFTIRQ
	select TASKLETS
	default n

config ADC
    bool "ADC subsystem"
	default n

config DAC
    bool "DAC subsystem"
	default n

config QEI
    bool "QEI subsystem"
	default n

config MCPWM
    bool "MCPWM subsystem"
	default n

config PWM
    bool "PWM subsystem"
	default n

config TIMER
    bool "Timer subsystem"
	default n

config MTD
    bool "MTD subsystem"
    default n

source os/src/rtc/Kconfig

config SPI
	bool "SPI subsystem"
	default n

config CAN
    bool "CAN subsystem"
	default n

config UART
 	bool "UART subsystem"
	default y

endmenu

config THREADS
    bool
	default y
	depends on !KERNEL_NONE
	depends on OS

config PROCESS
    bool
	default y
	depends on !KERNEL_NONE
	depends on OS

config TIMERS
	bool
	default y
	depends on !KERNEL_NONE
	depends on OS
```

## os/include/net/lwip/Kconfig
```kconfig
menu "lwIP options"

config NET_LWIP_MEMP_NUM_PBUF
	   int "Number of memp pbufs, should be high for high throughput"
	   default 256
	   depends on NET_LWIP

config NET_LWIP_MEMP_NUM_RAW_PCB
	   int "Number of raw connection PCBs"
	   default 32
	   depends on NET_LWIP

config NET_LWIP_MEMP_NUM_UDP_PCB
	   int "Number of udp protocol control blocks"
	   default 32
	   depends on NET_LWIP

config NET_LWIP_MEMP_NUM_TCP_PCB
	   int "Number of simultaneously active tcp connections"
	   default 32
	   depends on NET_LWIP

config NET_LWIP_MEMP_NUM_TCP_PCB_LISTEN
	   int "Number of listening TCP connections"
	   default 32
	   depends on NET_LWIP

config NET_LWIP_MEMP_NUM_TCP_SEG
	   int "The number of simultaneously queued TCP segments"
	   default 32
	   depends on NET_LWIP

config NET_LWIP_MEMP_NUM_REASSDATA
	   int "The number of IP packets simultaneously queued for reassembly"
	   default 64
	   depends on NET_LWIP

config NET_LWIP_MEMP_NUM_FRAG_PBUF
	   int "The number of IP fragments simultaneously sent"
	   default 32
	   depends on NET_LWIP

config NET_LWIP_MEMP_NUM_ARP_QUEUE
	   int "The number of simultaneously queued outgoing packets (pbufs) waiting on an ARP request"
	   default 32
	   depends on NET_LWIP

config NET_LWIP_MEMP_NUM_IGMP_GROUP
	   int "The number of multicast groups whose network interfaces can members at the same time."
	   default 	8
	   depends on NET_LWIP

config NET_LWIP_MEMP_NUM_NETBUF
	   int "The number of struct netconns."
	   default 32
	   depends on NET_LWIP

config NET_LWIP_MEMP_NUM_TCPIP_MSG_API
	   int "The number of struct tcpip_msg, which are used for callback/timeout API communication."
	   default 	32
	   depends on NET_LWIP

config NET_LWIP_MEMP_NUM_TCPIP_MSG_INPKT
	   int "The number of struct tcpip_msg, which are used"
	   default 32
	   depends on NET_LWIP

config NET_LWIP_MEMP_NUM_SNMP_NODE
	   int "The number of leafs in the SNMP tree."
	   default	50
	   depends on NET_LWIP

config NET_LWIP_MEMP_SNMP_ROOTNODE
	   int "The number of branches in the SNMP tree."
	   default 	30
	   depends on NET_LWIP

config NET_LWIP_MEMP_SNMP_VARBIND
	   int "The number of concurrent requests (does not have to be changed normally)"
	   default 2
	   depends on NET_LWIP

config NET_LWIP_PBUF_POOL_SIZE
	   int "The number of buffers in the pbuf pool"
	   default 256
	   depends on NET_LWIP

config NET_LWIP_ARP_TABLE_SIZE
	   int "The ARP table size"
	   default	64
	   depends on NET_LWIP

config NET_LWIP_IP_REASS_MAX_PBUFS
	   int "Total maximum amount of pbufs waiting to be reassembled."
	   default	128
	   depends on NET_LWIP

endmenu
```
