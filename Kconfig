## arch/arm/mach/stm32/ports/Kconfig.portB
```kconfig
#
#   PB0
#
menu "PB0"

choice STM32_PB0_FUNCTION
    prompt "Function"
    default STM32_PB0_GPIO

    config STM32_PB0_GPIO
        bool "GPIO"

    config STM32_PB0_AF
        bool "Alternate Function (peripheral)"
        ---help---
        Select this if you want to use a peripheral signal with this pin.
        You must further correctly configure the pin

endchoice

choice STM32_PB0_MODE
    prompt "PB0 Mode"
    default STM32_PB0_MODE_INPUT

    config STM32_PB0_MODE_INPUT
        bool "Input"

    config STM32_PB0_MODE_OUTPUT_2MHz
        bool "Output -  2MHz"

    config STM32_PB0_MODE_OUTPUT_10MHz
        bool "Output - 10MHz"

    config STM32_PB0_MODE_OUTPUT_50MHz
        bool "Output - 50MHz"

endchoice

choice STM32_PB0_CONF
    prompt "PB0 Config"
    default STM32_PB0_CONF_INPUT_FLOATING if STM32_PB0_MODE_INPUT
    default STM32_PB0_CONF_OUTPUT_PP if !STM32_PB0_MODE_INPUT

    config STM32_PB0_CONF_INPUT_FLOATING
        bool "Floating Input"
        depends on STM32_PB0_MODE_INPUT

    config STM32_PB0_CONF_INPUT_ANALOG
        bool "Analog Input"
        depends on STM32_PB0_MODE_INPUT

    config STM32_PB0_CONF_INPUT_PUPD
        bool "Input with pull-up/pull-down"
        depends on STM32_PB0_MODE_INPUT

    config STM32_PB0_CONF_OUTPUT_PP
        bool "Output - push-pull"
        depends on !STM32_PB0_MODE_INPUT

    config STM32_PB0_CONF_OUTPUT_OD
        bool "Output - open-drain"
        depends on !STM32_PB0_MODE_INPUT

endchoice
endmenu

#
#   PB1
#
menu "PB1"

choice STM32_PB1_FUNCTION
    prompt "Function"
    default STM32_PB1_GPIO

    config STM32_PB1_GPIO
        bool "GPIO"

    config STM32_PB1_AF
        bool "Alternate Function (peripheral)"
        ---help---
        Select this if you want to use a peripheral signal with this pin.
        You must further correctly configure the pin

endchoice

choice STM32_PB1_MODE
    prompt "PB1 Mode"
    default STM32_PB1_MODE_INPUT

    config STM32_PB1_MODE_INPUT
        bool "Input"

    config STM32_PB1_MODE_OUTPUT_2MHz
        bool "Output -  2MHz"

    config STM32_PB1_MODE_OUTPUT_10MHz
        bool "Output - 10MHz"

    config STM32_PB1_MODE_OUTPUT_50MHz
        bool "Output - 50MHz"

endchoice

choice STM32_PB1_CONF
    prompt "PB1 Config"
    default STM32_PB1_CONF_INPUT_FLOATING if STM32_PB1_MODE_INPUT
    default STM32_PB1_CONF_OUTPUT_PP if !STM32_PB1_MODE_INPUT

    config STM32_PB1_CONF_INPUT_FLOATING
        bool "Floating Input"
        depends on STM32_PB1_MODE_INPUT

    config STM32_PB1_CONF_INPUT_ANALOG
        bool "Analog Input"
        depends on STM32_PB1_MODE_INPUT

    config STM32_PB1_CONF_INPUT_PUPD
        bool "Input with pull-up/pull-down"
        depends on STM32_PB1_MODE_INPUT

    config STM32_PB1_CONF_OUTPUT_PP
        bool "Output - push-pull"
        depends on !STM32_PB1_MODE_INPUT

    config STM32_PB1_CONF_OUTPUT_OD
        bool "Output - open-drain"
        depends on !STM32_PB1_MODE_INPUT

endchoice
endmenu

#
#   PB2
#
menu "PB2"

choice STM32_PB2_FUNCTION
    prompt "Function"
    default STM32_PB2_GPIO

    config STM32_PB2_GPIO
        bool "GPIO"

    config STM32_PB2_AF
        bool "Alternate Function (peripheral)"
        ---help---
        Select this if you want to use a peripheral signal with this pin.
        You must further correctly configure the pin

endchoice

choice STM32_PB2_MODE
    prompt "PB2 Mode"
    default STM32_PB2_MODE_INPUT

    config STM32_PB2_MODE_INPUT
        bool "Input"

    config STM32_PB2_MODE_OUTPUT_2MHz
        bool "Output -  2MHz"

    config STM32_PB2_MODE_OUTPUT_10MHz
        bool "Output - 10MHz"

    config STM32_PB2_MODE_OUTPUT_50MHz
        bool "Output - 50MHz"

endchoice

choice STM32_PB2_CONF
    prompt "PB2 Config"
    default STM32_PB2_CONF_INPUT_FLOATING if STM32_PB2_MODE_INPUT
    default STM32_PB2_CONF_OUTPUT_PP if !STM32_PB2_MODE_INPUT

    config STM32_PB2_CONF_INPUT_FLOATING
        bool "Floating Input"
        depends on STM32_PB2_MODE_INPUT

    config STM32_PB2_CONF_INPUT_ANALOG
        bool "Analog Input"
        depends on STM32_PB2_MODE_INPUT

    config STM32_PB2_CONF_INPUT_PUPD
        bool "Input with pull-up/pull-down"
        depends on STM32_PB2_MODE_INPUT

    config STM32_PB2_CONF_OUTPUT_PP
        bool "Output - push-pull"
        depends on !STM32_PB2_MODE_INPUT

    config STM32_PB2_CONF_OUTPUT_OD
        bool "Output - open-drain"
        depends on !STM32_PB2_MODE_INPUT

endchoice
endmenu

#
#   PB3
#
menu "PB3"

choice STM32_PB3_FUNCTION
    prompt "Function"
    default STM32_PB3_GPIO

    config STM32_PB3_GPIO
        bool "GPIO"

    config STM32_PB3_AF
        bool "Alternate Function (peripheral)"
        ---help---
        Select this if you want to use a peripheral signal with this pin.
        You must further correctly configure the pin

endchoice

choice STM32_PB3_MODE
    prompt "PB3 Mode"
    default STM32_PB3_MODE_INPUT

    config STM32_PB3_MODE_INPUT
        bool "Input"

    config STM32_PB3_MODE_OUTPUT_2MHz
        bool "Output -  2MHz"

    config STM32_PB3_MODE_OUTPUT_10MHz
        bool "Output - 10MHz"

    config STM32_PB3_MODE_OUTPUT_50MHz
        bool "Output - 50MHz"

endchoice

choice STM32_PB3_CONF
    prompt "PB3 Config"
    default STM32_PB3_CONF_INPUT_FLOATING if STM32_PB3_MODE_INPUT
    default STM32_PB3_CONF_OUTPUT_PP if !STM32_PB3_MODE_INPUT

    config STM32_PB3_CONF_INPUT_FLOATING
        bool "Floating Input"
        depends on STM32_PB3_MODE_INPUT

    config STM32_PB3_CONF_INPUT_ANALOG
        bool "Analog Input"
        depends on STM32_PB3_MODE_INPUT

    config STM32_PB3_CONF_INPUT_PUPD
        bool "Input with pull-up/pull-down"
        depends on STM32_PB3_MODE_INPUT

    config STM32_PB3_CONF_OUTPUT_PP
        bool "Output - push-pull"
        depends on !STM32_PB3_MODE_INPUT

    config STM32_PB3_CONF_OUTPUT_OD
        bool "Output - open-drain"
        depends on !STM32_PB3_MODE_INPUT

endchoice
endmenu

#
#   PB4
#
menu "PB4"

choice STM32_PB4_FUNCTION
    prompt "Function"
    default STM32_PB4_GPIO

    config STM32_PB4_GPIO
        bool "GPIO"

    config STM32_PB4_AF
        bool "Alternate Function (peripheral)"
        ---help---
        Select this if you want to use a peripheral signal with this pin.
        You must further correctly configure the pin

endchoice

choice STM32_PB4_MODE
    prompt "PB4 Mode"
    default STM32_PB4_MODE_INPUT

    config STM32_PB4_MODE_INPUT
        bool "Input"

    config STM32_PB4_MODE_OUTPUT_2MHz
        bool "Output -  2MHz"

    config STM32_PB4_MODE_OUTPUT_10MHz
        bool "Output - 10MHz"

    config STM32_PB4_MODE_OUTPUT_50MHz
        bool "Output - 50MHz"

endchoice

choice STM32_PB4_CONF
    prompt "PB4 Config"
    default STM32_PB4_CONF_INPUT_FLOATING if STM32_PB4_MODE_INPUT
    default STM32_PB4_CONF_OUTPUT_PP if !STM32_PB4_MODE_INPUT

    config STM32_PB4_CONF_INPUT_FLOATING
        bool "Floating Input"
        depends on STM32_PB4_MODE_INPUT

    config STM32_PB4_CONF_INPUT_ANALOG
        bool "Analog Input"
        depends on STM32_PB4_MODE_INPUT

    config STM32_PB4_CONF_INPUT_PUPD
        bool "Input with pull-up/pull-down"
        depends on STM32_PB4_MODE_INPUT

    config STM32_PB4_CONF_OUTPUT_PP
        bool "Output - push-pull"
        depends on !STM32_PB4_MODE_INPUT

    config STM32_PB4_CONF_OUTPUT_OD
        bool "Output - open-drain"
        depends on !STM32_PB4_MODE_INPUT

endchoice
endmenu

#
#   PB5
#
menu "PB5"

choice STM32_PB5_FUNCTION
    prompt "Function"
    default STM32_PB5_GPIO

    config STM32_PB5_GPIO
        bool "GPIO"

    config STM32_PB5_AF
        bool "Alternate Function (peripheral)"
        ---help---
        Select this if you want to use a peripheral signal with this pin.
        You must further correctly configure the pin

endchoice

choice STM32_PB5_MODE
    prompt "PB5 Mode"
    default STM32_PB5_MODE_INPUT

    config STM32_PB5_MODE_INPUT
        bool "Input"

    config STM32_PB5_MODE_OUTPUT_2MHz
        bool "Output -  2MHz"

    config STM32_PB5_MODE_OUTPUT_10MHz
        bool "Output - 10MHz"

    config STM32_PB5_MODE_OUTPUT_50MHz
        bool "Output - 50MHz"

endchoice

choice STM32_PB5_CONF
    prompt "PB5 Config"
    default STM32_PB5_CONF_INPUT_FLOATING if STM32_PB5_MODE_INPUT
    default STM32_PB5_CONF_OUTPUT_PP if !STM32_PB5_MODE_INPUT

    config STM32_PB5_CONF_INPUT_FLOATING
        bool "Floating Input"
        depends on STM32_PB5_MODE_INPUT

    config STM32_PB5_CONF_INPUT_ANALOG
        bool "Analog Input"
        depends on STM32_PB5_MODE_INPUT

    config STM32_PB5_CONF_INPUT_PUPD
        bool "Input with pull-up/pull-down"
        depends on STM32_PB5_MODE_INPUT

    config STM32_PB5_CONF_OUTPUT_PP
        bool "Output - push-pull"
        depends on !STM32_PB5_MODE_INPUT

    config STM32_PB5_CONF_OUTPUT_OD
        bool "Output - open-drain"
        depends on !STM32_PB5_MODE_INPUT

endchoice
endmenu

#
#   PB6
#
menu "PB6"

choice STM32_PB6_FUNCTION
    prompt "Function"
    default STM32_PB6_GPIO

    config STM32_PB6_GPIO
        bool "GPIO"

    config STM32_PB6_AF
        bool "Alternate Function (peripheral)"
        ---help---
        Select this if you want to use a peripheral signal with this pin.
        You must further correctly configure the pin

endchoice

choice STM32_PB6_MODE
    prompt "PB6 Mode"
    default STM32_PB6_MODE_INPUT

    config STM32_PB6_MODE_INPUT
        bool "Input"

    config STM32_PB6_MODE_OUTPUT_2MHz
        bool "Output -  2MHz"

    config STM32_PB6_MODE_OUTPUT_10MHz
        bool "Output - 10MHz"

    config STM32_PB6_MODE_OUTPUT_50MHz
        bool "Output - 50MHz"

endchoice

choice STM32_PB6_CONF
    prompt "PB6 Config"
    default STM32_PB6_CONF_INPUT_FLOATING if STM32_PB6_MODE_INPUT
    default STM32_PB6_CONF_OUTPUT_PP if !STM32_PB6_MODE_INPUT

    config STM32_PB6_CONF_INPUT_FLOATING
        bool "Floating Input"
        depends on STM32_PB6_MODE_INPUT

    config STM32_PB6_CONF_INPUT_ANALOG
        bool "Analog Input"
        depends on STM32_PB6_MODE_INPUT

    config STM32_PB6_CONF_INPUT_PUPD
        bool "Input with pull-up/pull-down"
        depends on STM32_PB6_MODE_INPUT

    config STM32_PB6_CONF_OUTPUT_PP
        bool "Output - push-pull"
        depends on !STM32_PB6_MODE_INPUT

    config STM32_PB6_CONF_OUTPUT_OD
        bool "Output - open-drain"
        depends on !STM32_PB6_MODE_INPUT

endchoice
endmenu

#
#   PB7
#
menu "PB7"

choice STM32_PB7_FUNCTION
    prompt "Function"
    default STM32_PB7_GPIO

    config STM32_PB7_GPIO
        bool "GPIO"

    config STM32_PB7_AF
        bool "Alternate Function (peripheral)"
        ---help---
        Select this if you want to use a peripheral signal with this pin.
        You must further correctly configure the pin

endchoice

choice STM32_PB7_MODE
    prompt "PB7 Mode"
    default STM32_PB7_MODE_INPUT

    config STM32_PB7_MODE_INPUT
        bool "Input"

    config STM32_PB7_MODE_OUTPUT_2MHz
        bool "Output -  2MHz"

    config STM32_PB7_MODE_OUTPUT_10MHz
        bool "Output - 10MHz"

    config STM32_PB7_MODE_OUTPUT_50MHz
        bool "Output - 50MHz"

endchoice

choice STM32_PB7_CONF
    prompt "PB7 Config"
    default STM32_PB7_CONF_INPUT_FLOATING if STM32_PB7_MODE_INPUT
    default STM32_PB7_CONF_OUTPUT_PP if !STM32_PB7_MODE_INPUT

    config STM32_PB7_CONF_INPUT_FLOATING
        bool "Floating Input"
        depends on STM32_PB7_MODE_INPUT

    config STM32_PB7_CONF_INPUT_ANALOG
        bool "Analog Input"
        depends on STM32_PB7_MODE_INPUT

    config STM32_PB7_CONF_INPUT_PUPD
        bool "Input with pull-up/pull-down"
        depends on STM32_PB7_MODE_INPUT

    config STM32_PB7_CONF_OUTPUT_PP
        bool "Output - push-pull"
        depends on !STM32_PB7_MODE_INPUT

    config STM32_PB7_CONF_OUTPUT_OD
        bool "Output - open-drain"
        depends on !STM32_PB7_MODE_INPUT

endchoice
endmenu

#
#   PB8
#
menu "PB8"

choice STM32_PB8_FUNCTION
    prompt "Function"
    default STM32_PB8_GPIO

    config STM32_PB8_GPIO
        bool "GPIO"

    config STM32_PB8_AF
        bool "Alternate Function (peripheral)"
        ---help---
        Select this if you want to use a peripheral signal with this pin.
        You must further correctly configure the pin

endchoice

choice STM32_PB8_MODE
    prompt "PB8 Mode"
    default STM32_PB8_MODE_INPUT

    config STM32_PB8_MODE_INPUT
        bool "Input"

    config STM32_PB8_MODE_OUTPUT_2MHz
        bool "Output -  2MHz"

    config STM32_PB8_MODE_OUTPUT_10MHz
        bool "Output - 10MHz"

    config STM32_PB8_MODE_OUTPUT_50MHz
        bool "Output - 50MHz"

endchoice

choice STM32_PB8_CONF
    prompt "PB8 Config"
    default STM32_PB8_CONF_INPUT_FLOATING if STM32_PB8_MODE_INPUT
    default STM32_PB8_CONF_OUTPUT_PP if !STM32_PB8_MODE_INPUT

    config STM32_PB8_CONF_INPUT_FLOATING
        bool "Floating Input"
        depends on STM32_PB8_MODE_INPUT

    config STM32_PB8_CONF_INPUT_ANALOG
        bool "Analog Input"
        depends on STM32_PB8_MODE_INPUT

    config STM32_PB8_CONF_INPUT_PUPD
        bool "Input with pull-up/pull-down"
        depends on STM32_PB8_MODE_INPUT

    config STM32_PB8_CONF_OUTPUT_PP
        bool "Output - push-pull"
        depends on !STM32_PB8_MODE_INPUT

    config STM32_PB8_CONF_OUTPUT_OD
        bool "Output - open-drain"
        depends on !STM32_PB8_MODE_INPUT

endchoice
endmenu

#
#   PB9
#
menu "PB9"

choice STM32_PB9_FUNCTION
    prompt "Function"
    default STM32_PB9_GPIO

    config STM32_PB9_GPIO
        bool "GPIO"

    config STM32_PB9_AF
        bool "Alternate Function (peripheral)"
        ---help---
        Select this if you want to use a peripheral signal with this pin.
        You must further correctly configure the pin

endchoice

choice STM32_PB9_MODE
    prompt "PB9 Mode"
    default STM32_PB9_MODE_INPUT

    config STM32_PB9_MODE_INPUT
        bool "Input"

    config STM32_PB9_MODE_OUTPUT_2MHz
        bool "Output -  2MHz"

    config STM32_PB9_MODE_OUTPUT_10MHz
        bool "Output - 10MHz"

    config STM32_PB9_MODE_OUTPUT_50MHz
        bool "Output - 50MHz"

endchoice

choice STM32_PB9_CONF
    prompt "PB9 Config"
    default STM32_PB9_CONF_INPUT_FLOATING if STM32_PB9_MODE_INPUT
    default STM32_PB9_CONF_OUTPUT_PP if !STM32_PB9_MODE_INPUT

    config STM32_PB9_CONF_INPUT_FLOATING
        bool "Floating Input"
        depends on STM32_PB9_MODE_INPUT

    config STM32_PB9_CONF_INPUT_ANALOG
        bool "Analog Input"
        depends on STM32_PB9_MODE_INPUT

    config STM32_PB9_CONF_INPUT_PUPD
        bool "Input with pull-up/pull-down"
        depends on STM32_PB9_MODE_INPUT

    config STM32_PB9_CONF_OUTPUT_PP
        bool "Output - push-pull"
        depends on !STM32_PB9_MODE_INPUT

    config STM32_PB9_CONF_OUTPUT_OD
        bool "Output - open-drain"
        depends on !STM32_PB9_MODE_INPUT

endchoice
endmenu

#
#   PB10
#
menu "PB10"

choice STM32_PB10_FUNCTION
    prompt "Function"
    default STM32_PB10_GPIO

    config STM32_PB10_GPIO
        bool "GPIO"

    config STM32_PB10_AF
        bool "Alternate Function (peripheral)"
        ---help---
        Select this if you want to use a peripheral signal with this pin.
        You must further correctly configure the pin

endchoice

choice STM32_PB10_MODE
    prompt "PB10 Mode"
    default STM32_PB10_MODE_INPUT

    config STM32_PB10_MODE_INPUT
        bool "Input"

    config STM32_PB10_MODE_OUTPUT_2MHz
        bool "Output -  2MHz"

    config STM32_PB10_MODE_OUTPUT_10MHz
        bool "Output - 10MHz"

    config STM32_PB10_MODE_OUTPUT_50MHz
        bool "Output - 50MHz"

endchoice

choice STM32_PB10_CONF
    prompt "PB10 Config"
    default STM32_PB10_CONF_INPUT_FLOATING if STM32_PB10_MODE_INPUT
    default STM32_PB10_CONF_OUTPUT_PP if !STM32_PB10_MODE_INPUT

    config STM32_PB10_CONF_INPUT_FLOATING
        bool "Floating Input"
        depends on STM32_PB10_MODE_INPUT

    config STM32_PB10_CONF_INPUT_ANALOG
        bool "Analog Input"
        depends on STM32_PB10_MODE_INPUT

    config STM32_PB10_CONF_INPUT_PUPD
        bool "Input with pull-up/pull-down"
        depends on STM32_PB10_MODE_INPUT

    config STM32_PB10_CONF_OUTPUT_PP
        bool "Output - push-pull"
        depends on !STM32_PB10_MODE_INPUT

    config STM32_PB10_CONF_OUTPUT_OD
        bool "Output - open-drain"
        depends on !STM32_PB10_MODE_INPUT

endchoice
endmenu

#
#   PB11
#
menu "PB11"

choice STM32_PB11_FUNCTION
    prompt "Function"
    default STM32_PB11_GPIO

    config STM32_PB11_GPIO
        bool "GPIO"

    config STM32_PB11_AF
        bool "Alternate Function (peripheral)"
        ---help---
        Select this if you want to use a peripheral signal with this pin.
        You must further correctly configure the pin

endchoice

choice STM32_PB11_MODE
    prompt "PB11 Mode"
    default STM32_PB11_MODE_INPUT

    config STM32_PB11_MODE_INPUT
        bool "Input"

    config STM32_PB11_MODE_OUTPUT_2MHz
        bool "Output -  2MHz"

    config STM32_PB11_MODE_OUTPUT_10MHz
        bool "Output - 10MHz"

    config STM32_PB11_MODE_OUTPUT_50MHz
        bool "Output - 50MHz"

endchoice

choice STM32_PB11_CONF
    prompt "PB11 Config"
    default STM32_PB11_CONF_INPUT_FLOATING if STM32_PB11_MODE_INPUT
    default STM32_PB11_CONF_OUTPUT_PP if !STM32_PB11_MODE_INPUT

    config STM32_PB11_CONF_INPUT_FLOATING
        bool "Floating Input"
        depends on STM32_PB11_MODE_INPUT

    config STM32_PB11_CONF_INPUT_ANALOG
        bool "Analog Input"
        depends on STM32_PB11_MODE_INPUT

    config STM32_PB11_CONF_INPUT_PUPD
        bool "Input with pull-up/pull-down"
        depends on STM32_PB11_MODE_INPUT

    config STM32_PB11_CONF_OUTPUT_PP
        bool "Output - push-pull"
        depends on !STM32_PB11_MODE_INPUT

    config STM32_PB11_CONF_OUTPUT_OD
        bool "Output - open-drain"
        depends on !STM32_PB11_MODE_INPUT

endchoice
endmenu

#
#   PB12
#
menu "PB12"

choice STM32_PB12_FUNCTION
    prompt "Function"
    default STM32_PB12_GPIO

    config STM32_PB12_GPIO
        bool "GPIO"

    config STM32_PB12_AF
        bool "Alternate Function (peripheral)"
        ---help---
        Select this if you want to use a peripheral signal with this pin.
        You must further correctly configure the pin

endchoice

choice STM32_PB12_MODE
    prompt "PB12 Mode"
    default STM32_PB12_MODE_INPUT

    config STM32_PB12_MODE_INPUT
        bool "Input"

    config STM32_PB12_MODE_OUTPUT_2MHz
        bool "Output -  2MHz"

    config STM32_PB12_MODE_OUTPUT_10MHz
        bool "Output - 10MHz"

    config STM32_PB12_MODE_OUTPUT_50MHz
        bool "Output - 50MHz"

endchoice

choice STM32_PB12_CONF
    prompt "PB12 Config"
    default STM32_PB12_CONF_INPUT_FLOATING if STM32_PB12_MODE_INPUT
    default STM32_PB12_CONF_OUTPUT_PP if !STM32_PB12_MODE_INPUT

    config STM32_PB12_CONF_INPUT_FLOATING
        bool "Floating Input"
        depends on STM32_PB12_MODE_INPUT

    config STM32_PB12_CONF_INPUT_ANALOG
        bool "Analog Input"
        depends on STM32_PB12_MODE_INPUT

    config STM32_PB12_CONF_INPUT_PUPD
        bool "Input with pull-up/pull-down"
        depends on STM32_PB12_MODE_INPUT

    config STM32_PB12_CONF_OUTPUT_PP
        bool "Output - push-pull"
        depends on !STM32_PB12_MODE_INPUT

    config STM32_PB12_CONF_OUTPUT_OD
        bool "Output - open-drain"
        depends on !STM32_PB12_MODE_INPUT

endchoice
endmenu

#
#   PB13
#
menu "PB13"

choice STM32_PB13_FUNCTION
    prompt "Function"
    default STM32_PB13_GPIO

    config STM32_PB13_GPIO
        bool "GPIO"

    config STM32_PB13_AF
        bool "Alternate Function (peripheral)"
        ---help---
        Select this if you want to use a peripheral signal with this pin.
        You must further correctly configure the pin

endchoice

choice STM32_PB13_MODE
    prompt "PB13 Mode"
    default STM32_PB13_MODE_INPUT

    config STM32_PB13_MODE_INPUT
        bool "Input"

    config STM32_PB13_MODE_OUTPUT_2MHz
        bool "Output -  2MHz"

    config STM32_PB13_MODE_OUTPUT_10MHz
        bool "Output - 10MHz"

    config STM32_PB13_MODE_OUTPUT_50MHz
        bool "Output - 50MHz"

endchoice

choice STM32_PB13_CONF
    prompt "PB13 Config"
    default STM32_PB13_CONF_INPUT_FLOATING if STM32_PB13_MODE_INPUT
    default STM32_PB13_CONF_OUTPUT_PP if !STM32_PB13_MODE_INPUT

    config STM32_PB13_CONF_INPUT_FLOATING
        bool "Floating Input"
        depends on STM32_PB13_MODE_INPUT

    config STM32_PB13_CONF_INPUT_ANALOG
        bool "Analog Input"
        depends on STM32_PB13_MODE_INPUT

    config STM32_PB13_CONF_INPUT_PUPD
        bool "Input with pull-up/pull-down"
        depends on STM32_PB13_MODE_INPUT

    config STM32_PB13_CONF_OUTPUT_PP
        bool "Output - push-pull"
        depends on !STM32_PB13_MODE_INPUT

    config STM32_PB13_CONF_OUTPUT_OD
        bool "Output - open-drain"
        depends on !STM32_PB13_MODE_INPUT

endchoice
endmenu

#
#   PB14
#
menu "PB14"

choice STM32_PB14_FUNCTION
    prompt "Function"
    default STM32_PB14_GPIO

    config STM32_PB14_GPIO
        bool "GPIO"

    config STM32_PB14_AF
        bool "Alternate Function (peripheral)"
        ---help---
        Select this if you want to use a peripheral signal with this pin.
        You must further correctly configure the pin

endchoice

choice STM32_PB14_MODE
    prompt "PB14 Mode"
    default STM32_PB14_MODE_INPUT

    config STM32_PB14_MODE_INPUT
        bool "Input"

    config STM32_PB14_MODE_OUTPUT_2MHz
        bool "Output -  2MHz"

    config STM32_PB14_MODE_OUTPUT_10MHz
        bool "Output - 10MHz"

    config STM32_PB14_MODE_OUTPUT_50MHz
        bool "Output - 50MHz"

endchoice

choice STM32_PB14_CONF
    prompt "PB14 Config"
    default STM32_PB14_CONF_INPUT_FLOATING if STM32_PB14_MODE_INPUT
    default STM32_PB14_CONF_OUTPUT_PP if !STM32_PB14_MODE_INPUT

    config STM32_PB14_CONF_INPUT_FLOATING
        bool "Floating Input"
        depends on STM32_PB14_MODE_INPUT

    config STM32_PB14_CONF_INPUT_ANALOG
        bool "Analog Input"
        depends on STM32_PB14_MODE_INPUT

    config STM32_PB14_CONF_INPUT_PUPD
        bool "Input with pull-up/pull-down"
        depends on STM32_PB14_MODE_INPUT

    config STM32_PB14_CONF_OUTPUT_PP
        bool "Output - push-pull"
        depends on !STM32_PB14_MODE_INPUT

    config STM32_PB14_CONF_OUTPUT_OD
        bool "Output - open-drain"
        depends on !STM32_PB14_MODE_INPUT

endchoice
endmenu

#
#   PB15
#
menu "PB15"

choice STM32_PB15_FUNCTION
    prompt "Function"
    default STM32_PB15_GPIO

    config STM32_PB15_GPIO
        bool "GPIO"

    config STM32_PB15_AF
        bool "Alternate Function (peripheral)"
        ---help---
        Select this if you want to use a peripheral signal with this pin.
        You must further correctly configure the pin

endchoice

choice STM32_PB15_MODE
    prompt "PB15 Mode"
    default STM32_PB15_MODE_INPUT

    config STM32_PB15_MODE_INPUT
        bool "Input"

    config STM32_PB15_MODE_OUTPUT_2MHz
        bool "Output -  2MHz"

    config STM32_PB15_MODE_OUTPUT_10MHz
        bool "Output - 10MHz"

    config STM32_PB15_MODE_OUTPUT_50MHz
        bool "Output - 50MHz"

endchoice

choice STM32_PB15_CONF
    prompt "PB15 Config"
    default STM32_PB15_CONF_INPUT_FLOATING if STM32_PB15_MODE_INPUT
    default STM32_PB15_CONF_OUTPUT_PP if !STM32_PB15_MODE_INPUT

    config STM32_PB15_CONF_INPUT_FLOATING
        bool "Floating Input"
        depends on STM32_PB15_MODE_INPUT

    config STM32_PB15_CONF_INPUT_ANALOG
        bool "Analog Input"
        depends on STM32_PB15_MODE_INPUT

    config STM32_PB15_CONF_INPUT_PUPD
        bool "Input with pull-up/pull-down"
        depends on STM32_PB15_MODE_INPUT

    config STM32_PB15_CONF_OUTPUT_PP
        bool "Output - push-pull"
        depends on !STM32_PB15_MODE_INPUT

    config STM32_PB15_CONF_OUTPUT_OD
        bool "Output - open-drain"
        depends on !STM32_PB15_MODE_INPUT

endchoice
endmenu
```
