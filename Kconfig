## arch/arm/mach/stm32/ports/Kconfig.portC
```kconfig
#
#   PC0
#
menu "PC0"

choice STM32_PC0_FUNCTION
    prompt "Function"
    default STM32_PC0_GPIO

    config STM32_PC0_GPIO
        bool "GPIO"

    config STM32_PC0_AF
        bool "Alternate Function (peripheral)"
        ---help---
        Select this if you want to use a peripheral signal with this pin.
        You must further correctly configure the pin

endchoice

choice STM32_PC0_MODE
    prompt "PC0 Mode"
    default STM32_PC0_MODE_INPUT

    config STM32_PC0_MODE_INPUT
        bool "Input"

    config STM32_PC0_MODE_OUTPUT_2MHz
        bool "Output -  2MHz"

    config STM32_PC0_MODE_OUTPUT_10MHz
        bool "Output - 10MHz"

    config STM32_PC0_MODE_OUTPUT_50MHz
        bool "Output - 50MHz"

endchoice

choice STM32_PC0_CONF
    prompt "PC0 Config"
    default STM32_PC0_CONF_INPUT_FLOATING if STM32_PC0_MODE_INPUT
    default STM32_PC0_CONF_OUTPUT_PP if !STM32_PC0_MODE_INPUT

    config STM32_PC0_CONF_INPUT_FLOATING
        bool "Floating Input"
        depends on STM32_PC0_MODE_INPUT

    config STM32_PC0_CONF_INPUT_ANALOG
        bool "Analog Input"
        depends on STM32_PC0_MODE_INPUT

    config STM32_PC0_CONF_INPUT_PUPD
        bool "Input with pull-up/pull-down"
        depends on STM32_PC0_MODE_INPUT

    config STM32_PC0_CONF_OUTPUT_PP
        bool "Output - push-pull"
        depends on !STM32_PC0_MODE_INPUT

    config STM32_PC0_CONF_OUTPUT_OD
        bool "Output - open-drain"
        depends on !STM32_PC0_MODE_INPUT

endchoice
endmenu

#
#   PC1
#
menu "PC1"

choice STM32_PC1_FUNCTION
    prompt "Function"
    default STM32_PC1_GPIO

    config STM32_PC1_GPIO
        bool "GPIO"

    config STM32_PC1_AF
        bool "Alternate Function (peripheral)"
        ---help---
        Select this if you want to use a peripheral signal with this pin.
        You must further correctly configure the pin

endchoice

choice STM32_PC1_MODE
    prompt "PC1 Mode"
    default STM32_PC1_MODE_INPUT

    config STM32_PC1_MODE_INPUT
        bool "Input"

    config STM32_PC1_MODE_OUTPUT_2MHz
        bool "Output -  2MHz"

    config STM32_PC1_MODE_OUTPUT_10MHz
        bool "Output - 10MHz"

    config STM32_PC1_MODE_OUTPUT_50MHz
        bool "Output - 50MHz"

endchoice

choice STM32_PC1_CONF
    prompt "PC1 Config"
    default STM32_PC1_CONF_INPUT_FLOATING if STM32_PC1_MODE_INPUT
    default STM32_PC1_CONF_OUTPUT_PP if !STM32_PC1_MODE_INPUT

    config STM32_PC1_CONF_INPUT_FLOATING
        bool "Floating Input"
        depends on STM32_PC1_MODE_INPUT

    config STM32_PC1_CONF_INPUT_ANALOG
        bool "Analog Input"
        depends on STM32_PC1_MODE_INPUT

    config STM32_PC1_CONF_INPUT_PUPD
        bool "Input with pull-up/pull-down"
        depends on STM32_PC1_MODE_INPUT

    config STM32_PC1_CONF_OUTPUT_PP
        bool "Output - push-pull"
        depends on !STM32_PC1_MODE_INPUT

    config STM32_PC1_CONF_OUTPUT_OD
        bool "Output - open-drain"
        depends on !STM32_PC1_MODE_INPUT

endchoice
endmenu

#
#   PC2
#
menu "PC2"

choice STM32_PC2_FUNCTION
    prompt "Function"
    default STM32_PC2_GPIO

    config STM32_PC2_GPIO
        bool "GPIO"

    config STM32_PC2_AF
        bool "Alternate Function (peripheral)"
        ---help---
        Select this if you want to use a peripheral signal with this pin.
        You must further correctly configure the pin

endchoice

choice STM32_PC2_MODE
    prompt "PC2 Mode"
    default STM32_PC2_MODE_INPUT

    config STM32_PC2_MODE_INPUT
        bool "Input"

    config STM32_PC2_MODE_OUTPUT_2MHz
        bool "Output -  2MHz"

    config STM32_PC2_MODE_OUTPUT_10MHz
        bool "Output - 10MHz"

    config STM32_PC2_MODE_OUTPUT_50MHz
        bool "Output - 50MHz"

endchoice

choice STM32_PC2_CONF
    prompt "PC2 Config"
    default STM32_PC2_CONF_INPUT_FLOATING if STM32_PC2_MODE_INPUT
    default STM32_PC2_CONF_OUTPUT_PP if !STM32_PC2_MODE_INPUT

    config STM32_PC2_CONF_INPUT_FLOATING
        bool "Floating Input"
        depends on STM32_PC2_MODE_INPUT

    config STM32_PC2_CONF_INPUT_ANALOG
        bool "Analog Input"
        depends on STM32_PC2_MODE_INPUT

    config STM32_PC2_CONF_INPUT_PUPD
        bool "Input with pull-up/pull-down"
        depends on STM32_PC2_MODE_INPUT

    config STM32_PC2_CONF_OUTPUT_PP
        bool "Output - push-pull"
        depends on !STM32_PC2_MODE_INPUT

    config STM32_PC2_CONF_OUTPUT_OD
        bool "Output - open-drain"
        depends on !STM32_PC2_MODE_INPUT

endchoice
endmenu

#
#   PC3
#
menu "PC3"

choice STM32_PC3_FUNCTION
    prompt "Function"
    default STM32_PC3_GPIO

    config STM32_PC3_GPIO
        bool "GPIO"

    config STM32_PC3_AF
        bool "Alternate Function (peripheral)"
        ---help---
        Select this if you want to use a peripheral signal with this pin.
        You must further correctly configure the pin

endchoice

choice STM32_PC3_MODE
    prompt "PC3 Mode"
    default STM32_PC3_MODE_INPUT

    config STM32_PC3_MODE_INPUT
        bool "Input"

    config STM32_PC3_MODE_OUTPUT_2MHz
        bool "Output -  2MHz"

    config STM32_PC3_MODE_OUTPUT_10MHz
        bool "Output - 10MHz"

    config STM32_PC3_MODE_OUTPUT_50MHz
        bool "Output - 50MHz"

endchoice

choice STM32_PC3_CONF
    prompt "PC3 Config"
    default STM32_PC3_CONF_INPUT_FLOATING if STM32_PC3_MODE_INPUT
    default STM32_PC3_CONF_OUTPUT_PP if !STM32_PC3_MODE_INPUT

    config STM32_PC3_CONF_INPUT_FLOATING
        bool "Floating Input"
        depends on STM32_PC3_MODE_INPUT

    config STM32_PC3_CONF_INPUT_ANALOG
        bool "Analog Input"
        depends on STM32_PC3_MODE_INPUT

    config STM32_PC3_CONF_INPUT_PUPD
        bool "Input with pull-up/pull-down"
        depends on STM32_PC3_MODE_INPUT

    config STM32_PC3_CONF_OUTPUT_PP
        bool "Output - push-pull"
        depends on !STM32_PC3_MODE_INPUT

    config STM32_PC3_CONF_OUTPUT_OD
        bool "Output - open-drain"
        depends on !STM32_PC3_MODE_INPUT

endchoice
endmenu

#
#   PC4
#
menu "PC4"

choice STM32_PC4_FUNCTION
    prompt "Function"
    default STM32_PC4_GPIO

    config STM32_PC4_GPIO
        bool "GPIO"

    config STM32_PC4_AF
        bool "Alternate Function (peripheral)"
        ---help---
        Select this if you want to use a peripheral signal with this pin.
        You must further correctly configure the pin

endchoice

choice STM32_PC4_MODE
    prompt "PC4 Mode"
    default STM32_PC4_MODE_INPUT

    config STM32_PC4_MODE_INPUT
        bool "Input"

    config STM32_PC4_MODE_OUTPUT_2MHz
        bool "Output -  2MHz"

    config STM32_PC4_MODE_OUTPUT_10MHz
        bool "Output - 10MHz"

    config STM32_PC4_MODE_OUTPUT_50MHz
        bool "Output - 50MHz"

endchoice

choice STM32_PC4_CONF
    prompt "PC4 Config"
    default STM32_PC4_CONF_INPUT_FLOATING if STM32_PC4_MODE_INPUT
    default STM32_PC4_CONF_OUTPUT_PP if !STM32_PC4_MODE_INPUT

    config STM32_PC4_CONF_INPUT_FLOATING
        bool "Floating Input"
        depends on STM32_PC4_MODE_INPUT

    config STM32_PC4_CONF_INPUT_ANALOG
        bool "Analog Input"
        depends on STM32_PC4_MODE_INPUT

    config STM32_PC4_CONF_INPUT_PUPD
        bool "Input with pull-up/pull-down"
        depends on STM32_PC4_MODE_INPUT

    config STM32_PC4_CONF_OUTPUT_PP
        bool "Output - push-pull"
        depends on !STM32_PC4_MODE_INPUT

    config STM32_PC4_CONF_OUTPUT_OD
        bool "Output - open-drain"
        depends on !STM32_PC4_MODE_INPUT

endchoice
endmenu

#
#   PC5
#
menu "PC5"

choice STM32_PC5_FUNCTION
    prompt "Function"
    default STM32_PC5_GPIO

    config STM32_PC5_GPIO
        bool "GPIO"

    config STM32_PC5_AF
        bool "Alternate Function (peripheral)"
        ---help---
        Select this if you want to use a peripheral signal with this pin.
        You must further correctly configure the pin

endchoice

choice STM32_PC5_MODE
    prompt "PC5 Mode"
    default STM32_PC5_MODE_INPUT

    config STM32_PC5_MODE_INPUT
        bool "Input"

    config STM32_PC5_MODE_OUTPUT_2MHz
        bool "Output -  2MHz"

    config STM32_PC5_MODE_OUTPUT_10MHz
        bool "Output - 10MHz"

    config STM32_PC5_MODE_OUTPUT_50MHz
        bool "Output - 50MHz"

endchoice

choice STM32_PC5_CONF
    prompt "PC5 Config"
    default STM32_PC5_CONF_INPUT_FLOATING if STM32_PC5_MODE_INPUT
    default STM32_PC5_CONF_OUTPUT_PP if !STM32_PC5_MODE_INPUT

    config STM32_PC5_CONF_INPUT_FLOATING
        bool "Floating Input"
        depends on STM32_PC5_MODE_INPUT

    config STM32_PC5_CONF_INPUT_ANALOG
        bool "Analog Input"
        depends on STM32_PC5_MODE_INPUT

    config STM32_PC5_CONF_INPUT_PUPD
        bool "Input with pull-up/pull-down"
        depends on STM32_PC5_MODE_INPUT

    config STM32_PC5_CONF_OUTPUT_PP
        bool "Output - push-pull"
        depends on !STM32_PC5_MODE_INPUT

    config STM32_PC5_CONF_OUTPUT_OD
        bool "Output - open-drain"
        depends on !STM32_PC5_MODE_INPUT

endchoice
endmenu

#
#   PC6
#
menu "PC6"

choice STM32_PC6_FUNCTION
    prompt "Function"
    default STM32_PC6_GPIO

    config STM32_PC6_GPIO
        bool "GPIO"

    config STM32_PC6_AF
        bool "Alternate Function (peripheral)"
        ---help---
        Select this if you want to use a peripheral signal with this pin.
        You must further correctly configure the pin

endchoice

choice STM32_PC6_MODE
    prompt "PC6 Mode"
    default STM32_PC6_MODE_INPUT

    config STM32_PC6_MODE_INPUT
        bool "Input"

    config STM32_PC6_MODE_OUTPUT_2MHz
        bool "Output -  2MHz"

    config STM32_PC6_MODE_OUTPUT_10MHz
        bool "Output - 10MHz"

    config STM32_PC6_MODE_OUTPUT_50MHz
        bool "Output - 50MHz"

endchoice

choice STM32_PC6_CONF
    prompt "PC6 Config"
    default STM32_PC6_CONF_INPUT_FLOATING if STM32_PC6_MODE_INPUT
    default STM32_PC6_CONF_OUTPUT_PP if !STM32_PC6_MODE_INPUT

    config STM32_PC6_CONF_INPUT_FLOATING
        bool "Floating Input"
        depends on STM32_PC6_MODE_INPUT

    config STM32_PC6_CONF_INPUT_ANALOG
        bool "Analog Input"
        depends on STM32_PC6_MODE_INPUT

    config STM32_PC6_CONF_INPUT_PUPD
        bool "Input with pull-up/pull-down"
        depends on STM32_PC6_MODE_INPUT

    config STM32_PC6_CONF_OUTPUT_PP
        bool "Output - push-pull"
        depends on !STM32_PC6_MODE_INPUT

    config STM32_PC6_CONF_OUTPUT_OD
        bool "Output - open-drain"
        depends on !STM32_PC6_MODE_INPUT

endchoice
endmenu

#
#   PC7
#
menu "PC7"

choice STM32_PC7_FUNCTION
    prompt "Function"
    default STM32_PC7_GPIO

    config STM32_PC7_GPIO
        bool "GPIO"

    config STM32_PC7_AF
        bool "Alternate Function (peripheral)"
        ---help---
        Select this if you want to use a peripheral signal with this pin.
        You must further correctly configure the pin

endchoice

choice STM32_PC7_MODE
    prompt "PC7 Mode"
    default STM32_PC7_MODE_INPUT

    config STM32_PC7_MODE_INPUT
        bool "Input"

    config STM32_PC7_MODE_OUTPUT_2MHz
        bool "Output -  2MHz"

    config STM32_PC7_MODE_OUTPUT_10MHz
        bool "Output - 10MHz"

    config STM32_PC7_MODE_OUTPUT_50MHz
        bool "Output - 50MHz"

endchoice

choice STM32_PC7_CONF
    prompt "PC7 Config"
    default STM32_PC7_CONF_INPUT_FLOATING if STM32_PC7_MODE_INPUT
    default STM32_PC7_CONF_OUTPUT_PP if !STM32_PC7_MODE_INPUT

    config STM32_PC7_CONF_INPUT_FLOATING
        bool "Floating Input"
        depends on STM32_PC7_MODE_INPUT

    config STM32_PC7_CONF_INPUT_ANALOG
        bool "Analog Input"
        depends on STM32_PC7_MODE_INPUT

    config STM32_PC7_CONF_INPUT_PUPD
        bool "Input with pull-up/pull-down"
        depends on STM32_PC7_MODE_INPUT

    config STM32_PC7_CONF_OUTPUT_PP
        bool "Output - push-pull"
        depends on !STM32_PC7_MODE_INPUT

    config STM32_PC7_CONF_OUTPUT_OD
        bool "Output - open-drain"
        depends on !STM32_PC7_MODE_INPUT

endchoice
endmenu

#
#   PC8
#
menu "PC8"

choice STM32_PC8_FUNCTION
    prompt "Function"
    default STM32_PC8_GPIO

    config STM32_PC8_GPIO
        bool "GPIO"

    config STM32_PC8_AF
        bool "Alternate Function (peripheral)"
        ---help---
        Select this if you want to use a peripheral signal with this pin.
        You must further correctly configure the pin

endchoice

choice STM32_PC8_MODE
    prompt "PC8 Mode"
    default STM32_PC8_MODE_INPUT

    config STM32_PC8_MODE_INPUT
        bool "Input"

    config STM32_PC8_MODE_OUTPUT_2MHz
        bool "Output -  2MHz"

    config STM32_PC8_MODE_OUTPUT_10MHz
        bool "Output - 10MHz"

    config STM32_PC8_MODE_OUTPUT_50MHz
        bool "Output - 50MHz"

endchoice

choice STM32_PC8_CONF
    prompt "PC8 Config"
    default STM32_PC8_CONF_INPUT_FLOATING if STM32_PC8_MODE_INPUT
    default STM32_PC8_CONF_OUTPUT_PP if !STM32_PC8_MODE_INPUT

    config STM32_PC8_CONF_INPUT_FLOATING
        bool "Floating Input"
        depends on STM32_PC8_MODE_INPUT

    config STM32_PC8_CONF_INPUT_ANALOG
        bool "Analog Input"
        depends on STM32_PC8_MODE_INPUT

    config STM32_PC8_CONF_INPUT_PUPD
        bool "Input with pull-up/pull-down"
        depends on STM32_PC8_MODE_INPUT

    config STM32_PC8_CONF_OUTPUT_PP
        bool "Output - push-pull"
        depends on !STM32_PC8_MODE_INPUT

    config STM32_PC8_CONF_OUTPUT_OD
        bool "Output - open-drain"
        depends on !STM32_PC8_MODE_INPUT

endchoice
endmenu

#
#   PC9
#
menu "PC9"

choice STM32_PC9_FUNCTION
    prompt "Function"
    default STM32_PC9_GPIO

    config STM32_PC9_GPIO
        bool "GPIO"

    config STM32_PC9_AF
        bool "Alternate Function (peripheral)"
        ---help---
        Select this if you want to use a peripheral signal with this pin.
        You must further correctly configure the pin

endchoice

choice STM32_PC9_MODE
    prompt "PC9 Mode"
    default STM32_PC9_MODE_INPUT

    config STM32_PC9_MODE_INPUT
        bool "Input"

    config STM32_PC9_MODE_OUTPUT_2MHz
        bool "Output -  2MHz"

    config STM32_PC9_MODE_OUTPUT_10MHz
        bool "Output - 10MHz"

    config STM32_PC9_MODE_OUTPUT_50MHz
        bool "Output - 50MHz"

endchoice

choice STM32_PC9_CONF
    prompt "PC9 Config"
    default STM32_PC9_CONF_INPUT_FLOATING if STM32_PC9_MODE_INPUT
    default STM32_PC9_CONF_OUTPUT_PP if !STM32_PC9_MODE_INPUT

    config STM32_PC9_CONF_INPUT_FLOATING
        bool "Floating Input"
        depends on STM32_PC9_MODE_INPUT

    config STM32_PC9_CONF_INPUT_ANALOG
        bool "Analog Input"
        depends on STM32_PC9_MODE_INPUT

    config STM32_PC9_CONF_INPUT_PUPD
        bool "Input with pull-up/pull-down"
        depends on STM32_PC9_MODE_INPUT

    config STM32_PC9_CONF_OUTPUT_PP
        bool "Output - push-pull"
        depends on !STM32_PC9_MODE_INPUT

    config STM32_PC9_CONF_OUTPUT_OD
        bool "Output - open-drain"
        depends on !STM32_PC9_MODE_INPUT

endchoice
endmenu

#
#   PC10
#
menu "PC10"

choice STM32_PC10_FUNCTION
    prompt "Function"
    default STM32_PC10_GPIO

    config STM32_PC10_GPIO
        bool "GPIO"

    config STM32_PC10_AF
        bool "Alternate Function (peripheral)"
        ---help---
        Select this if you want to use a peripheral signal with this pin.
        You must further correctly configure the pin

endchoice

choice STM32_PC10_MODE
    prompt "PC10 Mode"
    default STM32_PC10_MODE_INPUT

    config STM32_PC10_MODE_INPUT
        bool "Input"

    config STM32_PC10_MODE_OUTPUT_2MHz
        bool "Output -  2MHz"

    config STM32_PC10_MODE_OUTPUT_10MHz
        bool "Output - 10MHz"

    config STM32_PC10_MODE_OUTPUT_50MHz
        bool "Output - 50MHz"

endchoice

choice STM32_PC10_CONF
    prompt "PC10 Config"
    default STM32_PC10_CONF_INPUT_FLOATING if STM32_PC10_MODE_INPUT
    default STM32_PC10_CONF_OUTPUT_PP if !STM32_PC10_MODE_INPUT

    config STM32_PC10_CONF_INPUT_FLOATING
        bool "Floating Input"
        depends on STM32_PC10_MODE_INPUT

    config STM32_PC10_CONF_INPUT_ANALOG
        bool "Analog Input"
        depends on STM32_PC10_MODE_INPUT

    config STM32_PC10_CONF_INPUT_PUPD
        bool "Input with pull-up/pull-down"
        depends on STM32_PC10_MODE_INPUT

    config STM32_PC10_CONF_OUTPUT_PP
        bool "Output - push-pull"
        depends on !STM32_PC10_MODE_INPUT

    config STM32_PC10_CONF_OUTPUT_OD
        bool "Output - open-drain"
        depends on !STM32_PC10_MODE_INPUT

endchoice
endmenu

#
#   PC11
#
menu "PC11"

choice STM32_PC11_FUNCTION
    prompt "Function"
    default STM32_PC11_GPIO

    config STM32_PC11_GPIO
        bool "GPIO"

    config STM32_PC11_AF
        bool "Alternate Function (peripheral)"
        ---help---
        Select this if you want to use a peripheral signal with this pin.
        You must further correctly configure the pin

endchoice

choice STM32_PC11_MODE
    prompt "PC11 Mode"
    default STM32_PC11_MODE_INPUT

    config STM32_PC11_MODE_INPUT
        bool "Input"

    config STM32_PC11_MODE_OUTPUT_2MHz
        bool "Output -  2MHz"

    config STM32_PC11_MODE_OUTPUT_10MHz
        bool "Output - 10MHz"

    config STM32_PC11_MODE_OUTPUT_50MHz
        bool "Output - 50MHz"

endchoice

choice STM32_PC11_CONF
    prompt "PC11 Config"
    default STM32_PC11_CONF_INPUT_FLOATING if STM32_PC11_MODE_INPUT
    default STM32_PC11_CONF_OUTPUT_PP if !STM32_PC11_MODE_INPUT

    config STM32_PC11_CONF_INPUT_FLOATING
        bool "Floating Input"
        depends on STM32_PC11_MODE_INPUT

    config STM32_PC11_CONF_INPUT_ANALOG
        bool "Analog Input"
        depends on STM32_PC11_MODE_INPUT

    config STM32_PC11_CONF_INPUT_PUPD
        bool "Input with pull-up/pull-down"
        depends on STM32_PC11_MODE_INPUT

    config STM32_PC11_CONF_OUTPUT_PP
        bool "Output - push-pull"
        depends on !STM32_PC11_MODE_INPUT

    config STM32_PC11_CONF_OUTPUT_OD
        bool "Output - open-drain"
        depends on !STM32_PC11_MODE_INPUT

endchoice
endmenu

#
#   PC12
#
menu "PC12"

choice STM32_PC12_FUNCTION
    prompt "Function"
    default STM32_PC12_GPIO

    config STM32_PC12_GPIO
        bool "GPIO"

    config STM32_PC12_AF
        bool "Alternate Function (peripheral)"
        ---help---
        Select this if you want to use a peripheral signal with this pin.
        You must further correctly configure the pin

endchoice

choice STM32_PC12_MODE
    prompt "PC12 Mode"
    default STM32_PC12_MODE_INPUT

    config STM32_PC12_MODE_INPUT
        bool "Input"

    config STM32_PC12_MODE_OUTPUT_2MHz
        bool "Output -  2MHz"

    config STM32_PC12_MODE_OUTPUT_10MHz
        bool "Output - 10MHz"

    config STM32_PC12_MODE_OUTPUT_50MHz
        bool "Output - 50MHz"

endchoice

choice STM32_PC12_CONF
    prompt "PC12 Config"
    default STM32_PC12_CONF_INPUT_FLOATING if STM32_PC12_MODE_INPUT
    default STM32_PC12_CONF_OUTPUT_PP if !STM32_PC12_MODE_INPUT

    config STM32_PC12_CONF_INPUT_FLOATING
        bool "Floating Input"
        depends on STM32_PC12_MODE_INPUT

    config STM32_PC12_CONF_INPUT_ANALOG
        bool "Analog Input"
        depends on STM32_PC12_MODE_INPUT

    config STM32_PC12_CONF_INPUT_PUPD
        bool "Input with pull-up/pull-down"
        depends on STM32_PC12_MODE_INPUT

    config STM32_PC12_CONF_OUTPUT_PP
        bool "Output - push-pull"
        depends on !STM32_PC12_MODE_INPUT

    config STM32_PC12_CONF_OUTPUT_OD
        bool "Output - open-drain"
        depends on !STM32_PC12_MODE_INPUT

endchoice
endmenu

#
#   PC13
#
menu "PC13"

choice STM32_PC13_FUNCTION
    prompt "Function"
    default STM32_PC13_GPIO

    config STM32_PC13_GPIO
        bool "GPIO"

    config STM32_PC13_AF
        bool "Alternate Function (peripheral)"
        ---help---
        Select this if you want to use a peripheral signal with this pin.
        You must further correctly configure the pin

endchoice

choice STM32_PC13_MODE
    prompt "PC13 Mode"
    default STM32_PC13_MODE_INPUT

    config STM32_PC13_MODE_INPUT
        bool "Input"

    config STM32_PC13_MODE_OUTPUT_2MHz
        bool "Output -  2MHz"

    config STM32_PC13_MODE_OUTPUT_10MHz
        bool "Output - 10MHz"

    config STM32_PC13_MODE_OUTPUT_50MHz
        bool "Output - 50MHz"

endchoice

choice STM32_PC13_CONF
    prompt "PC13 Config"
    default STM32_PC13_CONF_INPUT_FLOATING if STM32_PC13_MODE_INPUT
    default STM32_PC13_CONF_OUTPUT_PP if !STM32_PC13_MODE_INPUT

    config STM32_PC13_CONF_INPUT_FLOATING
        bool "Floating Input"
        depends on STM32_PC13_MODE_INPUT

    config STM32_PC13_CONF_INPUT_ANALOG
        bool "Analog Input"
        depends on STM32_PC13_MODE_INPUT

    config STM32_PC13_CONF_INPUT_PUPD
        bool "Input with pull-up/pull-down"
        depends on STM32_PC13_MODE_INPUT

    config STM32_PC13_CONF_OUTPUT_PP
        bool "Output - push-pull"
        depends on !STM32_PC13_MODE_INPUT

    config STM32_PC13_CONF_OUTPUT_OD
        bool "Output - open-drain"
        depends on !STM32_PC13_MODE_INPUT

endchoice
endmenu

#
#   PC14
#
menu "PC14"

choice STM32_PC14_FUNCTION
    prompt "Function"
    default STM32_PC14_GPIO

    config STM32_PC14_GPIO
        bool "GPIO"

    config STM32_PC14_AF
        bool "Alternate Function (peripheral)"
        ---help---
        Select this if you want to use a peripheral signal with this pin.
        You must further correctly configure the pin

endchoice

choice STM32_PC14_MODE
    prompt "PC14 Mode"
    default STM32_PC14_MODE_INPUT

    config STM32_PC14_MODE_INPUT
        bool "Input"

    config STM32_PC14_MODE_OUTPUT_2MHz
        bool "Output -  2MHz"

    config STM32_PC14_MODE_OUTPUT_10MHz
        bool "Output - 10MHz"

    config STM32_PC14_MODE_OUTPUT_50MHz
        bool "Output - 50MHz"

endchoice

choice STM32_PC14_CONF
    prompt "PC14 Config"
    default STM32_PC14_CONF_INPUT_FLOATING if STM32_PC14_MODE_INPUT
    default STM32_PC14_CONF_OUTPUT_PP if !STM32_PC14_MODE_INPUT

    config STM32_PC14_CONF_INPUT_FLOATING
        bool "Floating Input"
        depends on STM32_PC14_MODE_INPUT

    config STM32_PC14_CONF_INPUT_ANALOG
        bool "Analog Input"
        depends on STM32_PC14_MODE_INPUT

    config STM32_PC14_CONF_INPUT_PUPD
        bool "Input with pull-up/pull-down"
        depends on STM32_PC14_MODE_INPUT

    config STM32_PC14_CONF_OUTPUT_PP
        bool "Output - push-pull"
        depends on !STM32_PC14_MODE_INPUT

    config STM32_PC14_CONF_OUTPUT_OD
        bool "Output - open-drain"
        depends on !STM32_PC14_MODE_INPUT

endchoice
endmenu

#
#   PC15
#
menu "PC15"

choice STM32_PC15_FUNCTION
    prompt "Function"
    default STM32_PC15_GPIO

    config STM32_PC15_GPIO
        bool "GPIO"

    config STM32_PC15_AF
        bool "Alternate Function (peripheral)"
        ---help---
        Select this if you want to use a peripheral signal with this pin.
        You must further correctly configure the pin

endchoice

choice STM32_PC15_MODE
    prompt "PC15 Mode"
    default STM32_PC15_MODE_INPUT

    config STM32_PC15_MODE_INPUT
        bool "Input"

    config STM32_PC15_MODE_OUTPUT_2MHz
        bool "Output -  2MHz"

    config STM32_PC15_MODE_OUTPUT_10MHz
        bool "Output - 10MHz"

    config STM32_PC15_MODE_OUTPUT_50MHz
        bool "Output - 50MHz"

endchoice

choice STM32_PC15_CONF
    prompt "PC15 Config"
    default STM32_PC15_CONF_INPUT_FLOATING if STM32_PC15_MODE_INPUT
    default STM32_PC15_CONF_OUTPUT_PP if !STM32_PC15_MODE_INPUT

    config STM32_PC15_CONF_INPUT_FLOATING
        bool "Floating Input"
        depends on STM32_PC15_MODE_INPUT

    config STM32_PC15_CONF_INPUT_ANALOG
        bool "Analog Input"
        depends on STM32_PC15_MODE_INPUT

    config STM32_PC15_CONF_INPUT_PUPD
        bool "Input with pull-up/pull-down"
        depends on STM32_PC15_MODE_INPUT

    config STM32_PC15_CONF_OUTPUT_PP
        bool "Output - push-pull"
        depends on !STM32_PC15_MODE_INPUT

    config STM32_PC15_CONF_OUTPUT_OD
        bool "Output - open-drain"
        depends on !STM32_PC15_MODE_INPUT

endchoice
endmenu
```
