## arch/arm/mach/lpc11xx/Kconfig
```kconfig
comment "LPC11xx Platform Options"

config MACH_PRIORITY_BITS
	int
	default 2
	

config MACH_LPC11xx_SYSCLOCK_IRC_FREQ
	int
	default 12000000

config HAS_CAN_0
	bool
	default n

config HAS_I2C
	bool
	default n

config HAS_SPI_0
	bool
	default n

config HAS_SPI_1
	bool
	default n	

config MACH_LPC11Axx
	bool
	default n
	
config MACH_LPC11Cxx
	bool
	default n

choice
	prompt "LPC11xx Chip Variant"
	default MACH_LPC11xx_LPC11C24

config MACH_LPC11xx_LPC11A02
    bool "LPC11A02"
    select MACH_LPC11CA02

config MACH_LPC11xx_LPC11A04
    bool "LPC11A04"
    select MACH_LPC11A04    

config MACH_LPC11xx_LPC11A11
    bool "LPC11A11"
    select MACH_LPC11A11    

config MACH_LPC11xx_LPC11A12FHN33
    bool "LPC11A12FHN33"
    select MACH_LPC11A12FHN33    

config MACH_LPC11xx_LPC11A12FBD48
    bool "LPC11A12FBD48"
    select MACH_LPC11A12FBD48
    
config MACH_LPC11xx_LPC11A13
    bool "LPC11A13"
    select MACH_LPC11A13    
    
config MACH_LPC11xx_LPC11A14FHN33
    bool "LPC11A14FHN33"
    select MACH_LPC11A14FHN33    

config MACH_LPC11xx_LPC11A14FBD48
    bool "LPC11A14FBD48"
    select MACH_LPC11A14FBD48    
    

config MACH_LPC11xx_LPC11C14
    bool "LPC11C14"
    select MACH_LPC11C14

config MACH_LPC11xx_LPC11C22
    bool "LPC11C22"
    select MACH_LPC11C22    

config MACH_LPC11xx_LPC11C24
    bool "LPC11C24"
    select MACH_LPC11C24    

config MACH_LPC11xx_LPC11D14
    bool "LPC11D14"
    select MACH_LPC11D14
    

endchoice

config MACH_LPC11xx_LPC11Cxx
	bool
	default n

config MACH_LPC11xx_LPC11Axx
	bool
	default n


if MACH_LPC11xx_LPC11A02
source arch/arm/mach/lpc11xx/.config/lpc11a02
endif

if MACH_LPC11xx_LPC11A04
source arch/arm/mach/lpc11xx/.config/lpc11a04
endif

if MACH_LPC11xx_LPC11A11
source arch/arm/mach/lpc11xx/.config/lpc11a11
endif

if MACH_LPC11xx_LPC11A12FHN33
source arch/arm/mach/lpc11xx/.config/lpc11a12FHN33
endif

if MACH_LPC11xx_LPC11A12FBD48
source arch/arm/mach/lpc11xx/.config/lpc11a12FBD48
endif

if MACH_LPC11xx_LPC11A13
source arch/arm/mach/lpc11xx/.config/lpc11a13
endif

if MACH_LPC11xx_LPC11A14FHN33
source arch/arm/mach/lpc11xx/.config/lpc11a14FHN33
endif

if MACH_LPC11xx_LPC11A14FBD48
source arch/arm/mach/lpc11xx/.config/lpc11a14FBD48
endif

if MACH_LPC11xx_LPC11C14
source arch/arm/mach/lpc11xx/.config/lpc11c14
endif

if MACH_LPC11xx_LPC11C22
source arch/arm/mach/lpc11xx/.config/lpc11c22
endif

if MACH_LPC11xx_LPC11C24
source arch/arm/mach/lpc11xx/.config/lpc11c24
endif

if MACH_LPC11xx_LPC11D14
source arch/arm/mach/lpc11xx/.config/lpc11d14
endif


config MACH_LPC11xx_GPIO_BASE  
	hex
	default 0x50000000
	
config MACH_LPC11xx_UART0_BASE 
	hex
	default 0x40008000
	
config MACH_LPC11xx_CAN0_BASE  
	hex
	default 0x40050000
	
config MACH_LPC11xx_I2C0_BASE 
	hex
	default 0x40000000
	
config MACH_LPC11xx_SPI0_BASE 
	hex
	default 0x40040000

config MACH_LPC11xx_SPI1_BASE 
	hex
	default 0x40058000
	
config MACH_LPC11xx_ADC0_BASE  
	hex
	default 0x4001C000
	

config MACH_LPC11xx_TIMER0_BASE
	hex
	default 0x4000C000
	
config MACH_LPC11xx_TIMER1_BASE
	hex
	default 0x40010000
	
config MACH_LPC11xx_TIMER2_BASE
	hex
	default 0x40014000
	
config MACH_LPC11xx_TIMER3_BASE
	hex
	default 0x40018000

config MACH_LPC11xx_TOTAL_GPIOS
	int
	default 40 if MACH_LPC11Cxx
	default 42 if MACH_LPC11Axx

config MAX_IRQ
	   int
	   default 48		   

config ARCH_ARM_SYSTICK_SRC0_DIV
    int
    default 2
    
choice 
	prompt "systick clock source"
	default LPC11xx_ARCH_ARM_SYSTICK_PROCESSOR_CLOCK
	
config LPC11xx_ARCH_ARM_SYSTICK_PROCESSOR_CLOCK
	bool "processor clock"
	
config LPC11xx_ARCH_ARM_SYSTICK_EXTERNAL_CLOCK
	bool "processor/2 clock"

endchoice

config ARCH_ARM_SYSTICK_CLKSRC
	hex
	default 0x00 if LPC11xx_ARCH_ARM_SYSTICK_EXTERNAL_CLOCK
	default 0x04 if LPC11xx_ARCH_ARM_SYSTICK_PROCESSOR_CLOCK 
    

menu "Peripheral Selection"

menu "ADC devices"

config MACH_LPC11xx_ADC
	bool
	default n
	select ADC
	
config MACH_LPC11xx_ADC_0
    bool "Use ADC(0) peripheral"
	default n
	select MACH_LPC11xx_ADC

config MACH_LPC11xx_ADC_0_INODE_NAME
	string "ADC(0) devfs name"
	default "adc0"
	depends on MACH_LPC11xx_ADC_0
	
endmenu

menu "CAN devices"

config MACH_LPC11xx_CAN
	bool
	default n
	select CAN
	
config MACH_LPC11xx_CAN_0
    bool "Use CAN(0) peripheral"
	default n
	select MACH_LPC11xx_CAN
	depends on HAS_CAN_0	

config MACH_LPC11xx_CAN_0_INODE_NAME
	string "CAN(0) devfs name"
	default "can0"
	depends on MACH_LPC11xx_CAN_0
endmenu	

menu "UART devices"

config MACH_LPC11xx_UART
	bool
	default n
	select UART

config MACH_LPC11xx_UART_0
    bool "Use UART(0) peripheral"
	default n
	select MACH_LPC11xx_UART

config MACH_LPC11xx_UART_0_INODE_NAME
	string "UART(0) devfs name"
	default "uart0"
	depends on MACH_LPC11xx_UART_0
endmenu

menu "I2C devices"

config MACH_LPC11xx_I2C
	bool
	default n
	select I2C

config MACH_LPC11xx_I2C_0
    bool "Use I2C(0) peripheral"
	default n	
	select MACH_LPC11xx_I2C

config MACH_LPC11xx_I2C_0_BUSID
	int "I2C(0) Bus ID"
	default 0
	depends on MACH_LPC11xx_I2C_0

choice 
	prompt "Bus Speed"
	default MACH_LPC11xx_I2C_0_SPEED_100KHZ
	depends on MACH_LPC11xx_I2C_0
	
config MACH_LPC11xx_I2C_0_SPEED_100KHZ
	bool "100kHz"
	
config MACH_LPC11xx_I2C_0_SPEED_400KHZ
	bool "400kHz"

config MACH_LPC11xx_I2C_0_SPEED_1000KHZ
	bool "1000kHz"

endchoice

config MACH_LPC11xx_I2C_0_SPEED
	int
	default 0 if MACH_LPC11xx_I2C_0_SPEED_100KHZ
	default 1 if MACH_LPC11xx_I2C_0_SPEED_400KHZ 
	default 2 if MACH_LPC11xx_I2C_0_SPEED_1000KHZ

endmenu

menu "SPI devices"

config MACH_LPC11xx_SPI
	bool
	default n
	select SPI

config MACH_LPC11xx_SPI_0
    bool "Use SPI(0) peripheral"
	default n
	select MACH_LPC11xx_SPI

config MACH_LPC11xx_SPI_0_INODE_NAME
	string "SPI(0) devfs name"
	default "spi0"
	depends on MACH_LPC11xx_SPI_0

config MACH_LPC11xx_SPI_1
    bool "Use SPI(1) peripheral"
	default n
	select MACH_LPC11xx_SPI

config MACH_LPC11xx_SPI_1_INODE_NAME
	string "SPI(1) devfs name"
	default "spi1"
	depends on MACH_LPC11xx_SPI_1

endmenu

menu "TIMER devices"

config MACH_LPC11xx_TIMER
	bool
	default n
	select TIMER

config MACH_LPC11xx_TIMER_0
    bool "Use TIMER(0) peripheral"
	default n
	select MACH_LPC11xx_TIMER

config MACH_LPC11xx_TIMER_0_INODE_NAME
	string "TIMER(0) devfs name"
	default "timer0"
	depends on MACH_LPC11xx_TIMER_0

config MACH_LPC11xx_TIMER_1
    bool "Use TIMER(1) peripheral"
	default n
	select MACH_LPC11xx_TIMER

config MACH_LPC11xx_TIMER_1_INODE_NAME
	string "TIMER(1) devfs name"
	default "timer1"
	depends on MACH_LPC11xx_TIMER_1

config MACH_LPC11xx_TIMER_2
    bool "Use TIMER(2) peripheral"
	default n
	select MACH_LPC11xx_TIMER

config MACH_LPC11xx_TIMER_2_INODE_NAME
	string "TIMER(2) devfs name"
	default "timer2"
	depends on MACH_LPC11xx_TIMER_2

config MACH_LPC11xx_TIMER_3
    bool "Use TIMER(3) peripheral"
	default n
	select MACH_LPC11xx_TIMER

config MACH_LPC11xx_TIMER_3_INODE_NAME
	string "TIMER(3) devfs name"
	default "timer3"
	depends on MACH_LPC11xx_TIMER_3
endmenu

endmenu

menu "GPIO configuration"
source arch/arm/mach/lpc11xx/.config/GPIO
endmenu


choice
	prompt "Boot Logger Device"
	default MACH_LPC11xx_BOOTLOG_NULL

config MACH_LPC11xx_BOOTLOG_UART_0
    bool "UART(0)"
	select MACH_LPC11xx_UART_0

config MACH_LPC11xx_BOOTLOG_NULL
    bool "/dev/null"

endchoice
    
```

## arch/arm/mach/lpc17xx/Kconfig
```kconfig
comment "LPC17xx Platform Options"


config MACH_LPC17xx_SYSCLOCK_IRC_FREQ
	int
	default 4000000

config HAS_CAN_0
	bool
	default n
	
config HAS_CAN_1
	bool
	default n

config HAS_I2C0
	bool
	default n
	
	
choice
	prompt "LPC17xx Chip Variant"
	default MACH_LPC17xx_LPC1769

config MACH_LPC17xx_LPC1769
    bool "LPC1769"
    select MACH_LPC1769

config MACH_LPC17xx_LPC1768
    bool "LPC1768"
    select MACH_LPC1768
    
config MACH_LPC17xx_LPC1767
    bool "LPC1767"
    select MACH_LPC1767
    
config MACH_LPC17xx_LPC1766
    bool "LPC1766"
    select MACH_LPC1766
    
config MACH_LPC17xx_LPC1765
    bool "LPC1765"
    select MACH_LPC1765
    
config MACH_LPC17xx_LPC1764
    bool "LPC1764"
    select MACH_LPC1764

config MACH_LPC17xx_LPC1763
    bool "LPC1763"
    select MACH_LPC1763

config MACH_LPC17xx_LPC1759
    bool "LPC1759"
    select MACH_LPC1759

config MACH_LPC17xx_LPC1758
    bool "LPC1758"
    select MACH_LPC1758
    
config MACH_LPC17xx_LPC1756
    bool "LPC1756"
    select MACH_LPC1756
    
config MACH_LPC17xx_LPC1754
    bool "LPC1754"
    select MACH_LPC1754
    
config MACH_LPC17xx_LPC1752
    bool "LPC1752"
    select MACH_LPC1752
    
config MACH_LPC17xx_LPC1751
    bool "LPC1751"
    select MACH_LPC1751
endchoice

if MACH_LPC17xx_LPC1769
source arch/arm/mach/lpc17xx/.config/lpc1769
endif

if MACH_LPC17xx_LPC1768
source arch/arm/mach/lpc17xx/.config/lpc1768
endif

if MACH_LPC17xx_LPC1767
source arch/arm/mach/lpc17xx/.config/lpc1767
endif

if MACH_LPC17xx_LPC1766
source arch/arm/mach/lpc17xx/.config/lpc1766
endif

if MACH_LPC17xx_LPC1765
source arch/arm/mach/lpc17xx/.config/lpc1765
endif

if MACH_LPC17xx_LPC1764
source arch/arm/mach/lpc17xx/.config/lpc1764
endif

if MACH_LPC17xx_LPC1763
source arch/arm/mach/lpc17xx/.config/lpc1763
endif

if MACH_LPC17xx_LPC1759
source arch/arm/mach/lpc17xx/.config/lpc1759
endif

if MACH_LPC17xx_LPC1758
source arch/arm/mach/lpc17xx/.config/lpc1758
endif

if MACH_LPC17xx_LPC1756
source arch/arm/mach/lpc17xx/.config/lpc1756
endif

if MACH_LPC17xx_LPC1754
source arch/arm/mach/lpc17xx/.config/lpc1754
endif

if MACH_LPC17xx_LPC1752
source arch/arm/mach/lpc17xx/.config/lpc1752
endif

if MACH_LPC17xx_LPC1751
source arch/arm/mach/lpc17xx/.config/lpc1751
endif


config MACH_LPC17xx_GPIO_BASE  
	hex
	default 0x2009C000
	
config MACH_LPC17xx_UART0_BASE 
	hex
	default 0x4000C000

config MACH_LPC17xx_UART1_BASE 
	hex
	default 0x40010000

config MACH_LPC17xx_UART2_BASE 
	hex
	default 0x40098000

config MACH_LPC17xx_UART3_BASE 
	hex
	default 0x4009C000

config MACH_LPC17xx_SPI0_BASE 
	hex
	default 0x40020000

config MACH_LPC17xx_SPI1_BASE 
	hex
	default 0x40088000

config MACH_LPC17xx_SPI2_BASE 
	hex
	default 0x40030000

config MACH_LPC17xx_I2C0_BASE 
	hex
	default 0x4001C000

config MACH_LPC17xx_I2C1_BASE 
	hex
	default 0x4005C000

config MACH_LPC17xx_I2C2_BASE 
	hex
	default 0x400A0000
	
config MACH_LPC17xx_CAN0_BASE  
	hex
	default 0x40044000
	depends on HAS_CAN_0

config MACH_LPC17xx_CAN1_BASE  
	hex
	default 0x40048000
	depends on HAS_CAN_1
	

config MACH_LPC17xx_TIMER0_BASE
	hex
	default 0x40004000
	
config MACH_LPC17xx_TIMER1_BASE
	hex
	default 0x40008000
	
config MACH_LPC17xx_TIMER2_BASE
	hex
	default 0x40090000
	
config MACH_LPC17xx_TIMER3_BASE
	hex
	default 0x40094000

config MACH_LPC17xx_TOTAL_GPIOS
	int
	default 128 if MACH_LPC17xx_LPC1769	
	
config MAX_IRQ
	   int
	   default 50		   

config ARCH_ARM_SYSTICK_SRC0_DIV
    int
    default 2
    
choice 
	prompt "systick clock source"
	default LPC17xx_ARCH_ARM_SYSTICK_PROCESSOR_CLOCK
	
config LPC17xx_ARCH_ARM_SYSTICK_PROCESSOR_CLOCK
	bool "processor clock"
	
config LPC17xx_ARCH_ARM_SYSTICK_EXTERNAL_CLOCK
	bool "external clock"

endchoice

config ARCH_ARM_SYSTICK_CLKSRC
	hex
	default 0x00 if LPC17xx_ARCH_ARM_SYSTICK_EXTERNAL_CLOCK
	default 0x04 if LPC17xx_ARCH_ARM_SYSTICK_PROCESSOR_CLOCK 

comment "device specific configuration"

menu "Peripheral Selection"

menu "CAN devices"

config MACH_LPC17xx_CAN
	bool
	default n
	
config MACH_LPC17xx_CAN_0

config MACH_LPC17xx_CAN_0
    bool "Use CAN(0) peripheral"
	default n
	select MACH_LPC17xx_CAN
	depends on HAS_CAN_0	

config MACH_LPC17xx_CAN_0_INODE_NAME
	string "CAN(0) devfs name"
	default "can0"
	depends on HAS_CAN_0

config MACH_LPC17xx_CAN_1

config MACH_LPC17xx_CAN_1
    bool "Use CAN(1) peripheral"
	default n
	select MACH_LPC17xx_CAN
	depends on HAS_CAN_1	

config MACH_LPC17xx_CAN_1_INODE_NAME
	string "CAN(1) devfs name"
	default "can1"
	depends on HAS_CAN_1
endmenu

menu "UART devices"

config MACH_LPC17xx_UART
	bool
	default n

config MACH_LPC17xx_UART_0
    bool "Use UART(0) peripheral"
	default n
	select MACH_LPC17xx_UART	

config MACH_LPC17xx_UART_0_INODE_NAME
	string "UART(0) devfs name"
	default "uart0"
	depends on MACH_LPC17xx_UART_0

config MACH_LPC17xx_UART_1
    bool "Use UART(1) peripheral"
	default n
	select MACH_LPC17xx_UART	

config MACH_LPC17xx_UART_1_INODE_NAME
	string "UART(1) devfs name"
	default "uart1"
	depends on MACH_LPC17xx_UART_1

config MACH_LPC17xx_UART_2
    bool "Use UART(2) peripheral"
	default n
	select MACH_LPC17xx_UART	

config MACH_LPC17xx_UART_2_INODE_NAME
	string "UART(2) devfs name"
	default "uart2"
	depends on MACH_LPC17xx_UART_2

config MACH_LPC17xx_UART_3
    bool "Use UART(3) peripheral"
	default n
	select MACH_LPC17xx_UART	

config MACH_LPC17xx_UART_3_INODE_NAME
	string "UART(3) devfs name"
	default "uart3"
	depends on MACH_LPC17xx_UART_3
endmenu

menu "SPI devices"

config MACH_LPC17xx_SPI
	bool
	default n

config MACH_LPC17xx_SPI_0
    bool "Use SPI(0) peripheral"
	default n
	select MACH_LPC17xx_SPI

config MACH_LPC17xx_SPI_0_INODE_NAME
	string "SPI(0) devfs name"
	default "spi0"
	depends on MACH_LPC17xx_SPI_0

config MACH_LPC17xx_SPI_1
    bool "Use SPI(1) peripheral"
	default n
	select MACH_LPC17xx_SPI

config MACH_LPC17xx_SPI_1_INODE_NAME
	string "SPI(1) devfs name"
	default "spi1"
	depends on MACH_LPC17xx_SPI_1

config MACH_LPC17xx_SPI_2
    bool "Use SPI(2) peripheral"
	default n
	select MACH_LPC17xx_SPI

config MACH_LPC17xx_SPI_2_INODE_NAME
	string "SPI(2) devfs name"
	default "spi2"
	depends on MACH_LPC17xx_SPI_2
endmenu

menu "I2C devices"

config MACH_LPC17xx_I2C
	bool
	default n

config MACH_LPC17xx_I2C_0
    bool "Use I2C(0) peripheral"
	default n
	select MACH_LPC17xx_I2C
	depends on HAS_I2C0

config MACH_LPC17xx_I2C_0_INODE_NAME
	string "I2C(0) devfs name"
	default "i2c0"
	depends on MACH_LPC17xx_I2C_0

config MACH_LPC17xx_I2C_1
    bool "Use I2C(1) peripheral"
	default n
	select MACH_LPC17xx_I2C

config MACH_LPC17xx_I2C_1_INODE_NAME
	string "I2C(1) devfs name"
	default "i2c1"
	depends on MACH_LPC17xx_I2C_1

config MACH_LPC17xx_I2C_2
    bool "Use I2C(2) peripheral"
	default n
	select MACH_LPC17xx_I2C

config MACH_LPC17xx_I2C_2_INODE_NAME
	string "I2C(2) devfs name"
	default "i2c2"
	depends on MACH_LPC17xx_I2C_2
endmenu

menu "TIMER devices"

config MACH_LPC17xx_TIMER
	bool
	default n

config MACH_LPC17xx_TIMER_0
    bool "Use TIMER(0) peripheral"
	default n
	select MACH_LPC17xx_TIMER

config MACH_LPC17xx_TIMER_0_INODE_NAME
	string "TIMER(0) devfs name"
	default "timer0"
	depends on MACH_LPC17xx_TIMER_0

config MACH_LPC17xx_TIMER_1
    bool "Use TIMER(1) peripheral"
	default n
	select MACH_LPC17xx_TIMER

config MACH_LPC17xx_TIMER_1_INODE_NAME
	string "TIMER(1) devfs name"
	default "timer1"
	depends on MACH_LPC17xx_TIMER_1

config MACH_LPC17xx_TIMER_2
    bool "Use TIMER(2) peripheral"
	default n
		select MACH_LPC17xx_TIMER

config MACH_LPC17xx_TIMER_2_INODE_NAME
	string "TIMER(2) devfs name"
	default "timer2"
	depends on MACH_LPC17xx_TIMER_2

config MACH_LPC17xx_TIMER_3
    bool "Use TIMER(3) peripheral"
	default n
		select MACH_LPC17xx_TIMER

config MACH_LPC17xx_TIMER_3_INODE_NAME
	string "TIMER(3) devfs name"
	default "timer3"
	depends on MACH_LPC17xx_TIMER_3
endmenu

endmenu

menu "GPIO configuration"
source arch/arm/mach/lpc17xx/.config/GPIO
endmenu

choice
	prompt "Boot Logger Device"
	default MACH_LPC17xx_BOOTLOG_NULL

config MACH_LPC17xx_BOOTLOG_UART_0
    bool "UART(0)"
	select MACH_LPC17xx_UART_0

config MACH_LPC17xx_BOOTLOG_UART_1
    bool "UART(1)"
	select MACH_LPC17xx_UART_1

config MACH_LPC17xx_BOOTLOG_UART_2
    bool "UART(2)"
	select MACH_LPC17xx_UART_2

config MACH_LPC17xx_BOOTLOG_UART_3
    bool "UART(3)"
	select MACH_LPC17xx_UART_3

config MACH_LPC17xx_BOOTLOG_NULL
    bool "/dev/null"

endchoice
    
```
