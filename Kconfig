## Kconfig
```kconfig
#
mainmenu "BitThunder Configuration"

config CONFIGURED
    bool
	default y

config PROJECT_CONFIG
	bool
	option env="PROJECT_CONFIG"
	default n

config PROJECT_DIR
	string
	default "scripts" if !PROJECT_CONFIG
	option env="PROJECT_DIR"

choice
	prompt "Build OS or Library"
	default OS

config OS
	bool "OS"

config LIB
    bool "Library"

endchoice


menu "Build System (dbuild)"

config DBUILD_PYTHON
    string "Python path"
	default "/usr/bin/python"
	---help---
	DBUILD uses Python to form pretty output. Ensure it has a valid python
	interpreter path here.

choice
	prompt "Build Host Platform"
	default HOST_LINUX

config HOST_LINUX
	bool "Linux"

config HOST_WINDOWS
	bool "Windows"

config HOST_OTHER
	bool "Other"

endchoice

config TOOLCHAIN
	string "Toolchain prefix"
	default "arm-none-eabi-"


choice
	prompt "Optimisation Level"
	default OPTIMISE_NONE

config OPTIMISE_NONE
	bool "No Optimisations"

config OPTIMISE_SIZE
    bool "-Os (Optimise for size)"

config OPTIMISE_SPEED
	bool "-O2 (Optimise for speed)"

config OPTIMISE_ULTRA_SPEED
	bool "-O3 (Optimise for ultra-speed (can increase code-size))"

endchoice


choice
	prompt "Warning Level"
	default WARN_NORMAL

config WARN_NORMAL
	bool "Normal warnings from compiler"

config WARN_ALL
	bool "-Wall on compiler"

config WARN_PEDANTIC
	bool "-Wall --pedantic"

config WARN_ERROR
	bool "-Wall -Werror"

config WARN_ERROR_PEDANTIC
	bool "-Wall -Werror --pedantic (For the insane)"

endchoice

config TOOLCHAIN_WARNING
	string
	default ""							if WARN_NORMAL
	default	"-Wall"						if WARN_ALL
	default "-Wall --pedantic"			if WARN_PEDANTIC
	default "-Wall -Werror"				if WARN_ERROR
	default "-Wall -Werror --pedantic" 	if WARN_ERROR_PEDANTIC

config TOOLCHAIN_OPTIMISATION
    string
	default "-Os" if OPTIMISE_SIZE
	default "-O0" if OPTIMISE_NONE
	default "-O2" if OPTIMISE_SPEED
	default "-O3" if OPTIMISE_ULTRA_SPEED

config TOOLCHAIN_DEBUG
    bool "Debug Symbols"
	default y

config TOOLCHAIN_DEBUG_FLAGS
	string
	default "-g" if TOOLCHAIN_DEBUG


choice
	prompt "Windows Build Environment"
	default WINDOWS_CYGWIN
	depends on HOST_WINDOWS

config WINDOWS_NATIVE
	bool "Windows Native"
	---help---
		Build natively in a CMD.exe environment with Windows style paths (like C:\cgywin\home)

config WINDOWS_CYGWIN
	bool "Cygwin"
	---help---
		Build natively in a Cygwin environment with POSIX style paths (like /cygdrive/c/cgywin/home)

config WINDOWS_MSYS
	bool "MSYS"
	---help---
		Build natively in a Cygwin environment with POSIX style paths (like /cygdrive/c/cgywin/home)

config WINDOWS_OTHER
	bool "Windows POSIX-like environment"
	---help---
		Build natively in another POSIX-like environment.  Additional support may be necessary

endchoice

menu "Build Configuration"

config BUILD_NOSTDLIB
	   bool "Disable stdlib linking"
	   default n
	   ---help---
	   Should be enabled for a pure standalone kernel.

config BUILD_GC_UNUSED
	   bool "Removed unused code/data"
	   default y
	   ---help---
	   Asks the linker to always remove unused data/code from the kernel.

config BUILD_DISASSEMBLE
	   bool "Create Assembly listing"
	   default y

config BUILD_DISASSEMBLE_SOURCE
	   bool "Source code in listing"
	   depends on BUILD_DISASSEMBLE
	   default n

endmenu

endmenu

menu "System Architecture"
source "arch/Kconfig"
endmenu

menu "OS Features"
depends on OS
source "os/Kconfig"
endmenu

menu "Drivers"
source "drivers/Kconfig"
endmenu

menu "Kernel Options"
source kernel/Kconfig
endmenu

if PROJECT_CONFIG
menu "Project Configuration"
source "$PROJECT_DIR/Kconfig"
endmenu
endif
```

## arch/Kconfig
```kconfig
#
# For a description of the syntax of this configuration file,
# see misc/tools/kconfig-language.txt.
#

choice
	prompt "CPU Architecture"
	default ARCH_ARM

config ARCH_ARM
	bool "ARM"
	---help---
		The ARM architectures

config ARCH_MICROBLAZE
	bool "MicroBlaze"
	---help---
		The MicroBlaze architecture

config ARCH_PPC
    bool "PPC"
	---help---
		The PowerPC architecture

endchoice

config ARCH
	string
	default "arm"		if ARCH_ARM
	default "microblaze" 	if ARCH_MICROBLAZE
	default "ppc"		if ARCH_PPC

config BIG_ENDIAN
    bool

config LITTLE_ENDIAN
    bool

config HAS_MMU
	bool
	default n

if ARCH_ARM
source arch/arm/Kconfig
endif

if ARCH_MICROBLAZE
source arch/microblaze/Kconfig
endif
```

## arch/arm/Kconfig
```kconfig
#
# For a description of the syntax of this configuration file,
# see misc/tools/kconfig-language.txt.
#

if ARCH_ARM
comment "ARM Options"

choice
	prompt "ARM chip selection"
	default MACH_ZYNQ

config MACH_BCM2835
	bool "BCM2835 (Raspberryi Pi)"
	select ARCH_ARM_ARM11

config MACH_IMX
	bool "IMX (6) Freescale"
	select ARCH_ARM_CORTEX_A9
	select ARCH_HAVE_FPU

config MACH_LPC11xx
	bool "LPC11xx Series"
	select ARCH_ARM_CORTEX_M0

config MACH_LPC17xx
	bool "LPC17xx Series"
	select ARCH_ARM_CORTEX_M3

config MACH_STM32
	bool "STM32"
	select ARCH_ARM_CORTEX_M3

config MACH_LM3Sxx
	bool "LM3Sxx Series"
	select ARCH_ARM_CORTEX_M3
	---help---
		TI Stellaris architectures (ARM Cortex-M3).

config MACH_ZYNQ
	bool "ZYNQ"
	select ARCH_ARM_CORTEX_A9
	select ARCH_HAVE_FPU
	---help---
		Xilinx Zynq Embedded processing platform

endchoice

config ARCH_ARM_CORTEX_M0
	bool
	select ARCH_IRQPRIO
	select LITTLE_ENDIAN

config ARCH_ARM_CORTEX_M3
	bool
	select ARCH_IRQPRIO
	select ARCH_HAVE_RAMVECTORS
	select LITTLE_ENDIAN

config ARCH_ARM_CORTEX_M4
	bool
	select ARCH_IRQPRIO
	select ARCH_HAVE_RAMVECTORS
	select LITTLE_ENDIAN

config ARCH_ARM_CORTEX_A9
    bool
	default n
	select CACHE_MAINTENANCE
	select ARCH_ARM_ARMv7
	select ARCH_ARM_ARMv7_A
	select LITTLE_ENDIAN
	select ARCH_ARM_BOOT

config ARCH_ARM_ARM11
    bool
    select LITTLE_ENDIAN
	select ARCH_ARM_BOOT
	select ARCH_ARM_ARMv6

config ARCH_ARM_ARMv6
	bool
	default n
	select LITTLE_ENDIAN
	select ARCH_ARM_BOOT

config ARCH_ARM_ARMv7
	bool
	default n

config ARCH_ARM_ARMv7_A
    bool
 	default n
 	select LITTLE_ENDIAN
 	select ARCH_ARM_BOOT
 	select ARCH_ARM_ARMv7

config ARCH_ARM_FAMILY
	string
	default "arm"		if ARCH_ARM_ARM7TDMI || ARCH_ARM_ARM926EJS || ARCH_ARM_ARM920T
	default "armv6"		if ARCH_ARM_ARM11
	default "armv6-m"	if ARCH_ARM_CORTEX_M0
	default "armv7-m"	if ARCH_ARM_CORTEX_M3 || ARCH_ARM_CORTEX_M4
	default "armv7-a"	if ARCH_ARM_ARMv7_A

config TOOLCHAIN_CPU
	string
	default "cortex-m0"		if ARCH_ARM_CORTEX_M0
	default "cortex-m3"		if ARCH_ARM_CORTEX_M3
	default "cortex-m4"		if ARCH_ARM_CORTEX_M4
	default "cortex-a9"		if ARCH_ARM_CORTEX_A9
	default "arm1176jzf-s"	if ARCH_ARM_ARM11

choice
	prompt "Floating point ABI"
	default TOOLCHAIN_FLOAT_SOFT

config TOOLCHAIN_FLOAT_HARD
	bool "hardfp"

config TOOLCHAIN_FLOAT_SOFTFP
	bool "softfp"

config TOOLCHAIN_FLOAT_SOFT
	bool "soft"

endchoice

config TOOLCHAIN_MACH_FLAGS
    string
	default "-mthumb -mcpu=cortex-m0" if ARCH_ARM_CORTEX_M0
	default "-mthumb -mcpu=cortex-m3" if ARCH_ARM_CORTEX_M3
	default "-mthumb" if ARCH_ARM_CORTEX_M4
	default "-mthumb -mthumb-interwork" if ARCH_ARM_THUMB
	default ""

config TOOLCHAIN_MFPU
	string
	default "-mfpu=neon" if ARCH_ARM_HAS_NEON

config TOOLCHAIN_FPU_ABI
	string
	default "-mfloat-abi=soft" if TOOLCHAIN_FLOAT_SOFT
	default "-mfloat-abi=softfp" if TOOLCHAIN_FLOAT_SOFTFP
	default "-mfloat-abi=hard" if TOOLCHAIN_FLOAT_HARD

config ARCH_ARM_HAS_NEON
	bool
	default n

config ARCH_ARM_BOOT
    bool
	default n

config ARCH_ARM_FPU
	bool "FPU support"
	default y
	depends on ARCH_CORTEXM4
	---help---
		Build in support for the ARM Cortex-M4 Floating Point Unit (FPU).
		Check your chip specifications first; not all Cortex-M4 chips support the FPU.

config ARCH_HAVE_MPU
	bool
	default n

config ARCH_HAVE_MMU
	bool

if ARCH_ARM_CORTEX_A9

config KERNEL_FREERTOS_CA9_MODERN_PORT
	bool "Modern FreeRTOS CA9 port (experimental)"
	default n

endif

source arch/arm/common/Kconfig

if MACH_STM32
source arch/arm/mach/stm32/Kconfig
endif

if MACH_LPC11xx
source arch/arm/mach/lpc11xx/Kconfig
endif

if MACH_LPC17xx
source arch/arm/mach/lpc17xx/Kconfig
endif

if MACH_LM3Sxx
source arch/arm/mach/lm3sxx/Kconfig
endif

if MACH_BCM2835
source arch/arm/mach/bcm2835/Kconfig
endif

if MACH_IMX
source arch/arm/mach/imx/Kconfig
endif

if MACH_ZYNQ
source arch/arm/mach/zynq/Kconfig
endif

config SUBARCH
    string
	default "bcm2835" if MACH_BCM2835
	default "imx"	  if MACH_IMX
	default "lpc11xx" if MACH_LPC11xx
	default "lpc17xx" if MACH_LPC17xx
	default "lm3sxx"  if MACH_LM3Sxx
	default "stm32"   if MACH_STM32
	default "zynq"	  if MACH_ZYNQ
endif

menu "Memory"
    source arch/arm/Kconfig.linker
endmenu

config ARCH_ARM_FULL_INIT
    bool "Full CPU initialisation"
	default n

config ARCH_ARM_THUMB
	bool "Compile with thumb"
	default n

config ARCH_ARM_THUMB_INTERWORK
	bool
	default y if ARCH_ARM_CORTEX_A9
	default n

config KERNEL_CFLAGS_REMOVE
	string
	default "-mthumb" if ARCH_ARM_THUMB && ARCH_ARM_THUMB_INTERWORK
	default "" if !ARCH_ARM_THUMB
```

## arch/arm/Kconfig.linker
```kconfig
config LINKER_MEMORY_DEFINED
	bool
	default n

config LINKER_MACH_FLASH
	bool
	default n

config LINKER_MACH_SRAM
	bool
	default n

config LINKER_MACH_RAM
	bool
	default n

config LINKER_MACH_INIT_SECTION_IN_FLASH
	bool
	default n

config LINKER_MACH_INIT_SECTION_IN_SRAM
	bool
	default n

config LINKER_MACH_INIT_SECTION_IN_RAM
	bool
	default n

config LINKER_MACH_TEXT_SECTION_IN_FLASH
	bool
	default n

config LINKER_MACH_TEXT_SECTION_IN_SRAM
	bool
	default n

config LINKER_MACH_TEXT_SECTION_IN_RAM
	bool
	default n

config LINKER_MACH_DATA_SECTION_IN_FLASH
	bool
	default n

config LINKER_MACH_DATA_SECTION_IN_SRAM
	bool
	default n

config LINKER_MACH_DATA_SECTION_IN_RAM
	bool
	default n

config LINKER_MACH_BSS_SECTION_IN_FLASH
	bool
	default n

config LINKER_MACH_BSS_SECTION_IN_SRAM
	bool
	default n

config LINKER_MACH_BSS_SECTION_IN_RAM
	bool
	default n

config LINKER_SECTION_FLASH
    bool "Flash / ROM Section"
    default LINKER_MACH_FLASH if LINKER_MEMORY_DEFINED
	default n

config LINKER_FLASH_START_ADDRESS
    hex "Flash start address (physical)"
	default MACH_FLASH_START if LINKER_MEMORY_DEFINED
	default 0x0
	depends on LINKER_SECTION_FLASH

config LINKER_FLASH_LENGTH
    hex "Flash length (bytes)"
	default MACH_FLASH_SIZE if LINKER_MEMORY_DEFINED
	default 0x0
	depends on LINKER_SECTION_FLASH

config LINKER_FLASH_RESERVED
	hex "Reserve Flash Memory for e.g. bootloader"
	default 0x0

config LINKER_SECTION_SRAM
    bool "SRAM / On-chip-memory section"
	default LINKER_MACH_SRAM if LINKER_MEMORY_DEFINED
	default n

config LINKER_SRAM_START_ADDRESS
    hex "SRAM begin address (physical)"
	default MACH_SRAM_START if LINKER_MEMORY_DEFINED
	default 0x0
	depends on LINKER_SECTION_SRAM

config LINKER_SRAM_LENGTH
    hex "SRAM length"
	default MACH_SRAM_SIZE if LINKER_MEMORY_DEFINED
	default 0x0
	depends on LINKER_SECTION_SRAM

config LINKER_SRAM_RESERVED
	hex "Reserve SRAM Memory for e.g. bootloader"
	default 0x0

config LINKER_HEAP_DOWN
	hex "Move HEAP down by xx bytes"
	default 0x0


config LINKER_SECTION_RAM
    bool "RAM (external DDR) section"
    default LINKER_MACH_RAM if LINKER_MEMORY_DEFINED
	default n

config LINKER_RAM_START_ADDRESS
    hex "RAM start address (physical)"
	default MACH_RAM_START if LINKER_MEMORY_DEFINED
	default 0x0
	depends on LINKER_SECTION_RAM

config LINKER_RAM_LENGTH
    hex "RAM length"
	default MACH_RAM_SIZE if LINKER_MEMORY_DEFINED
	default 0x0
	depends on LINKER_SECTION_RAM

choice LINKER_INIT_SECTION
    prompt "Init Section"
    default LINKER_INIT_SECTION_FLASH if LINKER_MACH_INIT_SECTION_IN_FLASH
    default LINKER_INIT_SECTION_SRAM  if LINKER_MACH_INIT_SECTION_IN_SRAM
    default LINKER_INIT_SECTION_RAM   if LINKER_MACH_INIT_SECTION_IN_RAM
    default LINKER_INIT_SECTION_FLASH

config LINKER_INIT_SECTION_FLASH
    bool "Flash"
	depends on LINKER_SECTION_FLASH

config LINKER_INIT_SECTION_SRAM
    bool "SRAM"
	depends on LINKER_SECTION_SRAM

config LINKER_INIT_SECTION_RAM
    bool "RAM"
	depends on LINKER_SECTION_RAM

endchoice

choice LINKER_TEXT_SECTION
    prompt "Text Section"
    default LINKER_TEXT_SECTION_FLASH if LINKER_MACH_TEXT_SECTION_IN_FLASH
    default LINKER_TEXT_SECTION_SRAM  if LINKER_MACH_TEXT_SECTION_IN_SRAM
    default LINKER_TEXT_SECTION_RAM   if LINKER_MACH_TEXT_SECTION_IN_RAM
    default LINKER_TEXT_SECTION_FLASH

config LINKER_TEXT_SECTION_FLASH
    bool "Flash"
	depends on LINKER_SECTION_FLASH

config LINKER_TEXT_SECTION_SRAM
    bool "SRAM"
	depends on LINKER_SECTION_SRAM

config LINKER_TEXT_SECTION_RAM
    bool "RAM"
	depends on LINKER_SECTION_RAM

endchoice

choice LINKER_DATA_SECTION
    prompt "Data Section"
    default LINKER_DATA_SECTION_FLASH if LINKER_MACH_DATA_SECTION_IN_FLASH
    default LINKER_DATA_SECTION_SRAM  if LINKER_MACH_DATA_SECTION_IN_SRAM
    default LINKER_DATA_SECTION_RAM   if LINKER_MACH_DATA_SECTION_IN_RAM
    default LINKER_DATA_SECTION_FLASH

config LINKER_DATA_SECTION_FLASH
    bool "Flash"
	depends on LINKER_SECTION_FLASH

config LINKER_DATA_SECTION_SRAM
    bool "SRAM"
	depends on LINKER_SECTION_SRAM

config LINKER_DATA_SECTION_RAM
    bool "RAM"
	depends on LINKER_SECTION_RAM

endchoice

choice LINKER_BSS_SECTION
    prompt "BSS Section"
    default LINKER_BSS_SECTION_FLASH if LINKER_MACH_BSS_SECTION_IN_FLASH
    default LINKER_BSS_SECTION_SRAM  if LINKER_MACH_BSS_SECTION_IN_SRAM
    default LINKER_BSS_SECTION_RAM   if LINKER_MACH_BSS_SECTION_IN_RAM
    default LINKER_BSS_SECTION_SRAM

config LINKER_BSS_SECTION_FLASH
    bool "Flash"
	depends on LINKER_SECTION_FLASH

config LINKER_BSS_SECTION_SRAM
    bool "SRAM"
	depends on LINKER_SECTION_SRAM

config LINKER_BSS_SECTION_RAM
    bool "RAM"
	depends on LINKER_SECTION_RAM

endchoice

config LINKER_STACK_SIZE
    hex "Inital Stack Size"
	default 0x100

config ARCH_ARM_IRQ_STACK
    bool
	default n

config LINKER_IRQ_STACK_SIZE
	hex "IRQ Stack Size"
	default 0x0 if!ARCH_ARM_IRQ_STACK
	default 0x100
```

## arch/arm/mach/bcm2835/Kconfig
```kconfig
comment "BCM2835 Platform Options"

config MACH_BCM2835_PLATFORM
    bool
	default y
	select ARCH_ARM_ARM11
	select ARCH_ARM_IRQ_STACK
	select HAS_MMU
	select LINKER_MEMORY_DEFINED
	select LINKER_MACH_RAM
	select LINKER_MACH_BSS_SECTION_IN_RAM
	select LINKER_MACH_DATA_SECTION_IN_RAM
	select LINKER_MACH_INIT_SECTION_IN_RAM
	select LINKER_MACH_TEXT_SECTION_IN_RAM

config MACH_RAM_START
	hex
	default 0x8000

config MACH_RAM_SIZE
	hex
	default 0x08000000

config MACH_BCM2835_SYSCLOCK_FREQ
	int "System clock frequency"
	default 250000000

menu "Peripheral Selection"

endmenu

choice
	prompt "Boot Logger Device"
	default MACH_BCM2835_BOOTLOG_NULL

config MACH_BCM2835_BOOTLOG_NULL
    bool "/dev/null"

endchoice

config MACH_BCM2835_TOTAL_IRQ
    int
	default 72
```

## arch/arm/mach/bcm2835/boards/Kconfig
```kconfig
menu "Board Selection"

comment "BCM2835 Board Selection"

choice
    prompt "BCM2835 Boards"
    default BCM2835_RASPBERRYPI_MODEL_A

config BCM2835_RASPBERRYPI_MODEL_A
    bool "RaspberryPi Model A"
    ---help---
        The original RaspberryPi board.

config BCM2835_RASPBERRYPI_MODEL_B
    bool "RaspberryPi Model B"

endchoice

config BOARD_DEFCONFIG_FILE
    string
    default "raspberrypi_model_a.defconfig" if BCM2835_RASPBERRYPI_MODEL_A
    default "raspberrypi_model_b.defconfig" if BCM2835_RASPBERRYPI_MODEL_B


endmenu
```
