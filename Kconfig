## arch/arm/mach/zynq/Kconfig
```kconfig
config MACH_ZYNQ_PLATFORM
	bool
	default y
	select ARCH_ARM_CORTEX_A9
	select ARCH_ARM_IRQ_STACK
	select HAS_MMU
	select ARCH_ARM_HAS_NEON

config CPU_CORES
	int
	default 2

comment "Zynq Platform Options"

choice
	prompt "Zynq Chip Variant"
	default MACH_ZYNQ_XC7Z020

config MACH_ZYNQ_XC7Z020
    bool "XC7Z020"

endchoice


menu "Startup Hooks"
config MACH_ZYNQ_USE_STARTUP
    bool "Use default Zynq startup hook."
	default y
	---help---
	Use startup hook code for Zynq platform provided by BitThunder.
	If this option is not enabled, then you will have to provide your own platform startup hooks
	to initialise memory etc. (Implement _bt_startup_init_hook() and _bt_startup_boot() functions).

config MACH_ZYNQ_STARTUP_PS7INIT
	bool "Call Xilinx generated ps7_init() and ps7_post_config() functions."
	default n
	depends on MACH_ZYNQ_USE_STARTUP
	---help---
	If a valid ps7_init.c file as generated by the Xilinx platform tools was linked into your
	BitThunder kernel, then this initialisation can hooked into the init code.

config MACH_ZYNQ_STARTUP_INIT_GT
    bool "Initialise the Global Timer."
	depends on MACH_ZYNQ_USE_STARTUP
	default n
	---help---
	Initialise the Cortex-A9's global timer to 0 at the moment the kernel boots.

config MACH_ZYNQ_STARTUP_DDR_RELOCATE
    bool "Relocate to DDR."
	depends on MACH_ZYNQ_USE_STARTUP
	default n
	---help---
	Relocates program from OCM into DDR, and re-configures the PHYSICAL address bus so that
	the DDR appears at address 0x0000_0000, and not 0x0010_0000 (1MB).

	This option will only work if you are booted directly from the OCM, and wish to be linked at
	address 0x0.

	NOTE: When using this option you MUST ensure that only 1 single DDR memory is available to the
	linker. DISABLE the SRAM section from the Memory configuration.

endmenu

config MACH_ZYNQ_SYSCLOCK_FREQ
	int "System clock frequency"
	default 33333333

menu "Peripheral Selection"

comment "CAN devices"
config MACH_ZYNQ_CAN_0
    bool "Use CAN(0) peripheral"
	default n

config MACH_ZYNQ_CAN_1
    bool "Use CAN(1) peripheral"
	default n

comment "Device Configuration (FPGA loading)"

config MACH_ZYNQ_DEVCFG
	bool "Use xdevcfg peripheral"
	default n
	---help---
	Allow bitstream files to be piped to the xdevcfg device file to load an fpga.

comment "Gigabit Ethernet MACs"

config MACH_ZYNQ_GEM_0
    bool "Use GEM (MAC) 0 peripheral"
	default n

config MACH_ZYNQ_GEM_0_PHY_ADDR
	int "GEM 0 PHY Address"
	default 5
	depends on MACH_ZYNQ_GEM_0

config MACH_ZYNQ_GEM_1
	bool "Use GEM (MAC) 1 peripheral"
	default n

config MACH_ZYNQ_GEM_1_PHY_ADDR
	bool "GEM 1 PHY Address"
	default 7
	depends on MACH_ZYNQ_GEM_1

config MACH_ZYNQ_GEM
	bool
	default y if MACH_ZYNQ_GEM_0 || MACH_ZYNQ_GEM_1

comment "GPIO"

config MACH_ZYNQ_GPIO
	bool "Enable GPIO (MIO) driver"
	default n

comment "I2C devices"

config MACH_ZYNQ_I2C
	bool
	default n
	select I2C

config MACH_ZYNQ_I2C_0
    bool "Use I2C(0) peripheral"
	select MACH_ZYNQ_I2C
	default n

config MACH_ZYNQ_I2C_0_BUSID
    int "I2C(0) Bus ID"
	default 0
	depends on MACH_ZYNQ_I2C_0

config MACH_ZYNQ_I2C_1
	bool "Use I2C(1) peripheral"
	select MACH_ZYNQ_I2C
	default n

config MACH_ZYNQ_I2C_1_BUSID
	int "I2C(1) Bus ID"
	default 1
	depends on MACH_ZYNQ_I2C_1

comment "SDIO (SDCard Interfaces)"
config MACH_ZYNQ_SDIO
	bool
	default n

config MACH_ZYNQ_SDIO_0
    bool "Use SDIO(0) peripheral"
	select MACH_ZYNQ_SDIO
	default n

config MACH_ZYNQ_SDIO_0_ALWAYS_PRESENT
	bool "Force SDIO(0) card present"
	default n
	depends on MACH_ZYNQ_SDIO_0

config MACH_ZYNQ_SDIO_1
    bool "Use SDIO(1) peripheral"
	select MACH_ZYNQ_SDIO
	default n

config MACH_ZYNQ_SDIO_1_ALWAYS_PRESENT
	bool "Force SDIO(1) card present"
	default n
	depends on MACH_ZYNQ_SDIO_1

config MACH_ZYNQ_QSPI
	bool "Use QSPI bus controller"
	default n
	select SPI

comment "UART devices"
config MACH_ZYNQ_UART
	bool
	default n

config MACH_ZYNQ_UART_0
    bool "Use UART(0) peripheral"
	select MACH_ZYNQ_UART
	default n

config MACH_ZYNQ_UART_0_INODE_NAME
	string "UART(0) devfs name"
	default "serial0"
	depends on MACH_ZYNQ_UART_0

config MACH_ZYNQ_UART_1
    bool "Use UART(1) peripheral"
	select MACH_ZYNQ_UART
	default n

config MACH_ZYNQ_UART_1_INODE_NAME
	string "UART(1) devfs name"
	default "serial1"
	depends on MACH_ZYNQ_UART_1

endmenu

choice
	prompt "Boot Logger Device"
	default MACH_ZYNQ_BOOTLOG_NULL
	---help---
	Selects which device should be used for the boot logger (boot console).

config MACH_ZYNQ_BOOTLOG_UART_0
    bool "UART(0)"
	select MACH_ZYNQ_UART_0

config MACH_ZYNQ_BOOTLOG_UART_1
    bool "UART(1)"
	select MACH_ZYNQ_UART_1

config MACH_ZYNQ_BOOTLOG_NULL
    bool "/dev/null"

endchoice



#
#	Linker Memory
#
```

## arch/arm/mach/zynq/boards/Kconfig
```kconfig
choice
    prompt "ZYNQ Boards"
    default ZYNQ_ZEDBOARD

config ZYNQ_MICROZED
    bool "MicroZED"
    ---help---
        Support for the MicroZED board

config ZYNQ_ZEDBOARD
    bool "Zedboard"
    ---help---
        Support for the ZEDBOARD

config ZYNQ_ZC702
    bool "Xilinx ZC702"
    ---help---
        Support for ZC702

config ZYNQ_ZC706
    bool "Xilinx ZX706"
    ---help---
        Support for ZC706

config ZYNQ_ZYBO
    bool "Zybo Board"
    ---help---
        Support for the ZyboBoard

endchoice

config BOARD_DEFCONFIG_FILE
    string
    default "zedboard.defconfig" if ZYNQ_ZEDBOARD
    default "microzed.defconfig" if ZYNQ_MICROZED
```

## arch/microblaze/Kconfig
```kconfig
config ARCH_MICROBLAZE
	bool
	default y
	select LINKER_MEMORY_DEFINED
	select LINKER_MACH_RAM
	select LINKER_MACH_BSS_SECTION_IN_RAM
	select LINKER_MACH_DATA_SECTION_IN_RAM
	select LINKER_MACH_INIT_SECTION_IN_RAM
	select LINKER_MACH_TEXT_SECTION_IN_RAM

config MACH_RAM_START
	hex
	default 0x0

config MACH_RAM_SIZE
	hex
	default 0x08000000


choice
	prompt "MicroBlaze Endianess"
	default ARCH_MICROBLAZE_LITTLE_ENDIAN

config ARCH_MICROBLAZE_LITTLE_ENDIAN
	bool "Little Endian"
	select LITTLE_ENDIAN

config ARCH_MICROBLAZE_BIG_ENDIAN
	bool "Big Endian"
	select BIG_ENDIAN


endchoice


menu "Memory"
    source arch/microblaze/Kconfig.linker
endmenu
```
