## arch/arm/mach/stm32/Kconfig
```kconfig
comment "STM32 Platform Options"

config MACH_STM32_PLATFORM
	bool
	default y
    select LINKER_MACH_BSS_SECTION_IN_SRAM
	select LINKER_MEMORY_DEFINED
	select LINKER_MACH_FLASH
	select LINKER_MACH_SRAM
	select LINKER_MACH_INIT_SECTION_IN_FLASH
	select LINKER_MACH_TEXT_SECTION_IN_FLASH
	select LINKER_MACH_DATA_SECTION_IN_SRAM
	select LINKER_MACH_BSS_SECTION_IN_SRAM

choice
	prompt "stm32 series"
	default MACH_STM32_STM32F1xx

config MACH_STM32_STM32F1xx
	bool "stm32f1xx"

config MACH_STM32_STM32F2xx
	bool "stm32f2xx"

config MACH_STM32_STM32F3xx
	bool "stm32f3xx"

config MACH_STM32_STM32F4xx
	bool "stm32f4xx"

endchoice

source arch/arm/mach/stm32/boards/Kconfig

config MACH_FLASH_START
	hex
	default 0x08000000

config MACH_FLASH_SIZE
	hex
	default 0x20000

config MACH_SRAM_START
	hex
	default 0x20000000

config MACH_SRAM_SIZE
	hex
	default 0x2000

config LINKER_STACK_SIZE
	hex
	default 0x100

config ARCH_ARM_SYSTICK_SRC0_DIV
    int
    default 8

config MACH_PRIORITY_BITS
	int
	default 3

choice
	prompt "systick clock source"
	default MACH_STM32_SYSTICK_PROCESSOR_CLOCK

config MACH_STM32_SYSTICK_PROCESSOR_CLOCK
	bool "processor clock"

config MACH_STM32_SYSTICK_EXTERNAL_CLOCK
	bool "processor/2 clock"

endchoice

config ARCH_ARM_SYSTICK_CLKSRC
	hex
	default 0x00 if MACH_STM32_SYSTICK_EXTERNAL_CLOCK
	default 0x04 if MACH_STM32_SYSTICK_PROCESSOR_CLOCK


#
#	This needs to be changed dependent on the chip variant.
#
config MACH_STM32_TOTAL_GPIOS
    int
	default 80

menu "GPIO Configuration"
source arch/arm/mach/stm32/ports/Kconfig
endmenu
```

## arch/arm/mach/stm32/boards/Kconfig
```kconfig
choice
    prompt "STM32 Boards"
    default STM32VL_DISCOVERY

config STM32VL_DISCOVERY
    bool "STM32VL-Discovery"
    ---help---
        The original discovery boards, with stlink-v1.

config STM32F4_DISCOVERY
    bool "STM32F4-Discovery"
    ---help---
        The F4 series discovery board.

endchoice

config BOARD_DEFCONFIG_FILE
    string
    default "stm32vl-discovery.defconfig" if STM32VL_DISCOVERY
    default "stm32f4-discovery.defconfig" if STM32F4_DISCOVERY
```

## arch/arm/mach/stm32/ports/Kconfig
```kconfig
if MACH_STM32_STM32F1xx
    source arch/arm/mach/stm32/ports/Kconfig.f1xx
endif

menu "Port A configuration"
	source arch/arm/mach/stm32/ports/Kconfig.portA
endmenu

menu "Port B configuration"
	source arch/arm/mach/stm32/ports/Kconfig.portB
endmenu

menu "Port C configuration"
	source arch/arm/mach/stm32/ports/Kconfig.portC
endmenu

menu "Port D configuration"
	source arch/arm/mach/stm32/ports/Kconfig.portD
endmenu

menu "Port E configuration"
	source arch/arm/mach/stm32/ports/Kconfig.portE
endmenu
```
