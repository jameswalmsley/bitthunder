## os/src/mm/Kconfig
```kconfig
menu "Memory Management"

config MEM_PAGE_ALLOCATOR
	bool "Page Based Allocation"
	default n

config MEM_PAGE_COHERENT_POOL
	bool "Coherent Memory Pool (for use by DMA devices)"
	default n
	---help---
	This pool is for use by drivers when the virtual memory manager is not available.
	It allows them to get a coarse-grain configured region of non-cached and coherent memory.

config MEM_PAGE_COHERENT_LENGTH
	hex "Coherent length"
	default 0x00100000
	depends on MEM_PAGE_COHERENT_POOL
	---help---
	Note. The length here will be rounded to your system's section size.

config MEM_KHEAP
    bool
	default y if !MEM_PAGE_ALLOCATOR
	default n if MEM_PAGE_ALLOCATOR

config MEM_SLAB_ALLOCATOR
	bool
    depends on MEM_PAGE_ALLOCATOR
	default y

config MEM_SLAB_MAX_ORDER
	int "Slab Max order"
	depends on MEM_SLAB_ALLOCATOR
	default 16
	---help---
	1 = 16 bytes, 10 = 8192 bytes, 16 = 512k.
	Allocation requests with greater orders will be passed to the page allocator.

config USE_VIRTUAL_ADDRESSING
    depends on HAS_MMU
	bool "Virtual Memory Support"
	default n
	select MEM_PAGE_ALLOCATOR

config RAM_PHYS
	depends on HAS_MMU
	hex
	default (LINKER_RAM_START_ADDRESS)

config RAM_VIRT
    depends on HAS_MMU
	hex
	default 0xC0000000 if USE_VIRTUAL_ADDRESSING
	default 0x0

config TRACE_MALLOC
	bool "Trace calls to BT_kMalloc() / BT_kFree()"
	default n


endmenu
```

## os/src/net/Kconfig
```kconfig
menu "Networking"

config NET
    bool
    select TASKLETS
	default n
	
config SUPPORTS_UDP
	bool
	default n

config SUPPORTS_TCP
	bool
	default n

config SUPPORTS_DHCP
	bool
	default n

config SUPPORTS_IGMP
	bool
	default n

config NET_LWIP
    bool "Lightweight IP TCP/IP stack"
	select NET
	select SUPPORTS_UDP
	select SUPPORTS_TCP
	select SUPPORTS_DHCP
	select SUPPORTS_IGMP	
	default n

config BOOL_USE_TCP
    bool "use TCP"
	depends on SUPPORTS_TCP
	default y

config BOOL_USE_UDP
    bool "use UDP"
	depends on SUPPORTS_UDP
	default n

config BOOL_USE_DHCP
    bool "use DHCP"
	depends on SUPPORTS_UDP
	select BOOL_USE_UDP
	default n

config BOOL_USE_IGMP
    bool "use IGMP"
	depends on SUPPORTS_IGMP
	select BOOL_USE_UDP
	default n

config USE_TCP
    int 
    default 1 if BOOL_USE_TCP	
	default 0

config USE_UDP
    int 
    default 1 if BOOL_USE_UDP
	default 0

config USE_DHCP
    int 
    default 1 if BOOL_USE_DHCP	
	default 0

config USE_IGMP
    int 
    default 1 if BOOL_USE_IGMP	
	default 0


endmenu
```

## os/src/process/Kconfig
```kconfig
menu "Process Manager"

config MAX_PROCESS_NAME
    int "Max Process Name Length"
	default 10

config PROCESS_CWD
     bool "Support for a CWD"
     default n

config ALIVE_LED
    bool "Alive! LED"
	default n
	
config ALIVE_LED_GPIO
    int "GPIO Line to use for Alive! LED"
	default -1
	depends on ALIVE_LED

config ALIVE_LED_PERIOD
    int "Alive! LED Period (Ticks)"
	default 1000
	depends on ALIVE_LED

config ALIVE_LED_PRIORITY
    int "Alive! LED task priority"
	default 0
	depends on ALIVE_LED

config ALIVE_LED_INVERTED
    bool "Invert GPIO polarity"
	default n
	depends on ALIVE_LED

endmenu
```

## os/src/shell/Kconfig
```kconfig
menu "Kernel Shell"
config SHELL
    bool "Enable Kernel Shell"
	default n

source os/src/shell/commands/Kconfig

config SHELL_JIMTCL
	bool "Use JimTCL"
	---help---
	Causes the default kernel shell to be a TCL shell.
	There is a breakout command (bt) which allows escaping onto the standard BitThunder kernel shell.
	However the all commands aim to provide equivalent functionality through some well designed
	TCL bindings.

config SHELL_MICROPYTHON
	bool "Use MicroPython"
	---help---
	Enables the use of MicroPython as a kernel shell.


endmenu
```

## os/src/shell/commands/Kconfig
```kconfig
menu "Commands"

config SHELL_CMD_ATAGS
	bool "ATAG Support"
	depends on SHELL
	default n

if SHELL_CMD_ATAGS
source os/src/shell/commands/atag/Kconfig
endif

config SHELL_CMD_BOOT
    bool "boot"
	depends on SHELL
	default n

config SHELL_CMD_BOOT_JTAG
    bool "boot_jtag"
	depends on SHELL
	default n

config SHELL_CMD_CAT
	bool "cat"
	depends on SHELL
	default n
	select FILE

config SHELL_CMD_CD
    bool "cd"
	depends on SHELL
	depends on PROCESS_CWD
	default n
	select FILE

config SHELL_CMD_CP
    bool "cp"
	depends on SHELL
	default n
	select FILE

config SHELL_CMD_CP_BUFFER_SIZE
	int "cp buffer size"
	depends on SHELL_CMD_CP
	default 4096

config SHELL_CMD_ECHO
	bool "echo"
	depends on SHELL
	default n

config SHELL_CMD_EXEC
	bool "exec"
	depends on SHELL
	default n

config SHELL_CMD_FLASHTOOL
	bool "flashtool"
	depends on SHELL
	default n

config SHELL_CMD_FREE
	bool "free"
	depends on SHELL
	default n

config SHELL_CMD_GETENV
	bool "getenv"
	depends on SHELL
	default n

config SHELL_CMD_GPIO
	bool "gpio"
	depends on SHELL
	default n

config SHELL_CMD_HELP
    bool "help"
	depends on SHELL
	default n

config SHELL_CMD_IOMEM
	bool "iomem"
	depends on SHELL
	default n

config SHELL_CMD_LOAD
    bool "load"
	depends on SHELL
	default n
	select FILE

config SHELL_CMD_LOAD_FPGA
    bool "load_fpga"
	depends on SHELL
	default n
	select FILE

config SHELL_CMD_LS
	bool "ls"
	depends on SHELL
	default n
	select FILE

config SHELL_CMD_MD5SUM
	bool "md5sum"
	depends on SHELL
	default n
	select FILE

config SHELL_CMD_MEMCAT
	bool "memcat"
	depends on SHELL
	default n
	select FILE

config SHELL_CMD_MOUNT
	bool "mount"
	depends on SHELL
	default n
	select FILE

config SHELL_CMD_PS
	bool "ps"
	depends on SHELL
	default n

config SHELL_CMD_PWD
	bool "pwd"
	depends on SHELL
	depends on PROCESS_CWD
	default n

config SHELL_CMD_SETENV
	bool "setenv"
	depends on SHELL
	default n

config SHELL_CMD_SLABTOP
	bool "slabtop"
	depends on SHELL
	default n

config SHELL_CMD_SLEEP
	bool "sleep"
	depends on SHELL
	default n

config SHELL_CMD_SOURCE
	bool "source"
	depends on SHELL
	default n
	select FILE

config SHELL_CMD_TFTP
	bool "tftp"
	depends on SHELL
	default n

endmenu
```

## os/src/shell/commands/atag/Kconfig
```kconfig
menu "ATAG Blob Generation"

config SHELL_CMD_ATAG_RAMDISK
    bool "atag_ramdisk (Ramdisk TAG support)."
	default n

config SHELL_CMD_ATAG_INITRD2
    bool "atag_initrd2 (initrd2 TAG support)."
	default n

config SHELL_CMD_ATAG_MEM
    bool "atag_mem (Memory region TAG support)."
	default n

config SHELL_CMD_ATAG_CMDLINE
    bool "atag_cmdline (Command Line TAG support)."
	default n


endmenu
```

## os/src/syscall/Kconfig
```kconfig
menu "System Calls"

config SYSCALL
	bool "System Call Mechanism"
	default n


endmenu
```

## os/src/syslog/Kconfig
```kconfig
menu "Syslog"

config SYSLOG_REMOVE_PRINTK
    bool "Remove all calls to BT_kPrint()"
	default n	 if LIB_PRINTF
	default y	 if !LIB_PRINTF

config SYSLOG_SYSTICK
    bool "Use SysTick Timer for BT_kPrint() outputs"
    default n


choice SYSLOG_LINE_ENDINGS
    prompt "kPrint line endings"
	default SYSLOG_LINE_ENDINGS_LF

config SYSLOG_LINE_ENDINGS_CR
    bool "Carriage Return (\"\\n\")"

config SYSLOG_LINE_ENDINGS_LF
    bool "Line Feed (\"\\r\")"

config SYSLOG_LINE_ENDINGS_CRLF
    bool "CRLF (\"\\n\\r\")"

config SYSLOG_LINE_ENDINGS_LFCR
    bool "LFCR (\"\\r\\n\")"

endchoice


endmenu
```

## os/src/time/Kconfig
```kconfig
menu "Time"

config TIME_CLOCK_SOURCE
	   string "Real Time Clock Source device"
	   default "/dev/rtc0"

endmenu
```

## scripts/mkimage/example.its
```
/*
 * Simple BootThunder FIT source file.
 */

/dts-v1/;
/ {
	description = "Simple image BitThunder kernel";
	#address-cells = <1>;

	images {
		btkernel: kernel@1 {
			description = "Vanilla BitThunder kernel";
			data = /incbin/("./kernel.img");
			type = "kernel";
			arch = "arm";
			os = "bitthunder";
			compression = "none";
			load = <0x18000000>;
			entry = <0x18008000>;
			hash@1 {
				algo = "crc32";
			};

			hash@2 {
				algo = "sha1";
			};

			hash@3 {
				algo = "md5";
			};
		};

		fpga: fpga@2 {
			 description = "FPGA bitstream";
			 data = /incbin/("./fpga.bin");
			 compression = "none";
			 type = "bitstream";
			 
			 hash@1 {
			 	algo = "crc32";				
			 };

			 hash@2 {
			 	algo = "sha1";
			 };

			 hash@3 {
			 	algo = "md5";
			 };
		};
	};

	configurations {
		default = "config@1";
		config@1 {
			description = "Boot BitThunder kernel with default fpga";
			kernel = "kernel@1";
			fpga = "fpga@2";
			fpga_device = "/dev/xdevcfg";
		};

		config@2 {
			description = "Boot BitThunder kernel with alternative fpga";
			kernel = "kernel@1";
			fpga = "fpga@2";
			fpga_device = "/dev/xdevcfg";
		};
	};
};
```
